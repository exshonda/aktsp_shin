AUTOSAR XML (schema 4-0-3)
package /Os
  module config Os: ecuc-def-edition=4.0.3, implementation-config-variant=VARIANT-PRE-COMPILE
    OsInclude: OsIncludeFileName=out.h
    MainApp (OsAppMode)
    OsOS: OsStackMonitoring=true, OsStatus=EXTENDED, OsUseGetServiceId=true, OsUseParameterAccess=true, OsScalabilityClass=SC1
      OsHooks: OsErrorHook=false, OsPostTaskHook=false, OsPreTaskHook=false, OsProtectionHook=false, OsShutdownHook=false, OsStartupHook=false
      OsHookStack: OsHookStackSize=AKTSP_HOOK_STACK_SIZE
      OsOsStack: OsOsStackSize=AKTSP_OS_STACK_SIZE, OsOsStackStartAddress=aktg_os_stack+AKTSP_BUFFER_STACK_SIZE
    MainTask (OsTask):
      OsTaskActivation = 1
      OsTaskPriority = 0
      OsTaskSchedule = FULL
      OsTaskStackSize = AKTSP_TASK_STACK_SIZE
      OsTaskResourceRef = DummyResource
      OsTaskEventRef = DummyEvent
      OsTaskAutostart: OsTaskAppModeRef=MainApp
    DummyTask (OsTask): OsTaskActivation=1, OsTaskPriority=15, OsTaskSchedule=FULL, OsTaskStackSize=AKTSP_TASK_STACK_SIZE, OsTaskResourceRef=DummyResource
    DummyResource (OsResource): OsResourceProperty=STANDARD
    DummyEvent (OsEvent)
    AKTG_C2ISR_FOR_HWCNT (OsIsr):
      OsIsrCategory = CATEGORY_2
      OsIsrInterruptNumber = AKTSP_INTNO_HWCNT
      OsIsrInterruptPriority = 5
      OsIsrInterruptSource = ENABLE
      OsIsrStackSize = AKTSP_C2ISR_STACK_SIZE
    DUMMY_HARDWARE_COUNTER (OsCounter):
      OsCounterMaxAllowedValue = 10
      OsCounterMinCycle = 2
      OsCounterTicksPerBase = 1
      OsCounterType = HARDWARE
      OsSecondsPerTick = 1.0
      OsCounterIsrRef = AKTG_C2ISR_FOR_HWCNT
    3 x OsTask, all with OsTaskActivation=1, OsTaskPriority=10, OsTaskSchedule=FULL, OsTaskStackSize=AKTSP_TASK_STACK_SIZE:
      TASK1: OsTaskStackStartAddress=aktg_stack[0]
      TASK2: OsTaskStackStartAddress=aktg_stack[1]
      TASK3: OsTaskStackStartAddress=aktg_stack[2]
    ALARM1 (OsAlarm): OsAlarmCounterRef=DUMMY_HARDWARE_COUNTER
      OsAlarmAction
        OsAlarmActivateTask: OsAlarmActivateTaskRef=TASK2
    ALARM2 (OsAlarm): OsAlarmCounterRef=DUMMY_HARDWARE_COUNTER
      OsAlarmAction
        OsAlarmActivateTask: OsAlarmActivateTaskRef=TASK3
