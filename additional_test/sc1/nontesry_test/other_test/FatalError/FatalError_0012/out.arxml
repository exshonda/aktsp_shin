AUTOSAR XML (schema 4-0-3)
package /Os
  module config Os: ecuc-def-edition=4.0.3, implementation-config-variant=VARIANT-PRE-COMPILE
    OsInclude: OsIncludeFileName=out.h
    MainApp (OsAppMode)
    OsOS: OsStackMonitoring=true, OsStatus=EXTENDED, OsUseGetServiceId=true, OsUseParameterAccess=true, OsScalabilityClass=SC1
      OsHooks: OsErrorHook=false, OsPostTaskHook=false, OsPreTaskHook=false, OsProtectionHook=false, OsShutdownHook=false, OsStartupHook=false
      OsHookStack: OsHookStackSize=AKTSP_HOOK_STACK_SIZE
      OsOsStack: OsOsStackSize=AKTSP_OS_STACK_SIZE, OsOsStackStartAddress=aktg_os_stack+AKTSP_BUFFER_STACK_SIZE
    MainTask (OsTask):
      OsTaskActivation = 1
      OsTaskPriority = 0
      OsTaskSchedule = FULL
      OsTaskStackSize = AKTSP_TASK_STACK_SIZE
      OsTaskResourceRef = DummyResource
      OsTaskEventRef = DummyEvent
      OsTaskAutostart: OsTaskAppModeRef=MainApp
    DummyTask (OsTask): OsTaskActivation=1, OsTaskPriority=15, OsTaskSchedule=FULL, OsTaskStackSize=AKTSP_TASK_STACK_SIZE, OsTaskResourceRef=DummyResource
    DummyResource (OsResource): OsResourceProperty=STANDARD
    DummyEvent (OsEvent)
    AKTG_C2ISR_COMMON_AKTSP_INTNO_G (OsIsr):
      OsIsrCategory = CATEGORY_2
      OsIsrInterruptNumber = AKTSP_INTNO_G
      OsIsrInterruptPriority = 3
      OsIsrInterruptSource = ENABLE
      OsIsrStackSize = AKTSP_C2ISR_STACK_SIZE
      OsIsrResourceRef = RESOURCE1
    TASK1 (OsTask):
      OsTaskActivation = 1
      OsTaskPriority = 10
      OsTaskSchedule = FULL
      OsTaskStackSize = AKTSP_TASK_STACK_SIZE
      OsTaskStackStartAddress = aktg_stack[0]
      OsTaskResourceRef = RESOURCE1
    TASK2 (OsTask):
      OsTaskActivation = 1
      OsTaskPriority = 11
      OsTaskSchedule = FULL
      OsTaskStackSize = AKTSP_TASK_STACK_SIZE
      OsTaskStackStartAddress = aktg_stack[1]
      OsTaskResourceRef = RESOURCE1
    RESOURCE1 (OsResource): OsResourceProperty=STANDARD
