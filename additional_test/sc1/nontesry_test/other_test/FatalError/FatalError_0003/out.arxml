AUTOSAR XML (schema 4-0-3)
package /Os
  module config Os: ecuc-def-edition=4.0.3, implementation-config-variant=VARIANT-PRE-COMPILE
    OsInclude: OsIncludeFileName=out.h
    MainApp (OsAppMode)
    OsOS: OsStackMonitoring=true, OsStatus=EXTENDED, OsUseGetServiceId=true, OsUseParameterAccess=true, OsScalabilityClass=SC1
      OsHooks: OsErrorHook=false, OsPostTaskHook=false, OsPreTaskHook=false, OsProtectionHook=false, OsShutdownHook=false, OsStartupHook=false
      OsHookStack: OsHookStackSize=AKTSP_HOOK_STACK_SIZE
      OsOsStack: OsOsStackSize=AKTSP_OS_STACK_SIZE, OsOsStackStartAddress=aktg_os_stack+AKTSP_BUFFER_STACK_SIZE
    MainTask (OsTask):
      OsTaskActivation = 1
      OsTaskPriority = 0
      OsTaskSchedule = FULL
      OsTaskStackSize = AKTSP_TASK_STACK_SIZE
      OsTaskResourceRef = DummyResource
      OsTaskEventRef = DummyEvent
      OsTaskAutostart: OsTaskAppModeRef=MainApp
    DummyTask (OsTask): OsTaskActivation=1, OsTaskPriority=15, OsTaskSchedule=FULL, OsTaskStackSize=AKTSP_TASK_STACK_SIZE, OsTaskResourceRef=DummyResource
    DummyResource (OsResource): OsResourceProperty=STANDARD
    DummyEvent (OsEvent)
    3 x OsTask, all with OsTaskSchedule=FULL, OsTaskStackSize=AKTSP_TASK_STACK_SIZE:
      TASK1: OsTaskActivation=1, OsTaskPriority=10, OsTaskStackStartAddress=aktg_stack[0]
      TASK2: OsTaskActivation=2, OsTaskPriority=10, OsTaskStackStartAddress=aktg_stack[1]
      TASK3: OsTaskActivation=2, OsTaskPriority=9, OsTaskStackStartAddress=aktg_stack[2]
