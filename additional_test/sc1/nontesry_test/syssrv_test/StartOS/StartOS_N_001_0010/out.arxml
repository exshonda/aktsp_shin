AUTOSAR XML (schema 4-0-3)
package /Os
  module config Os: ecuc-def-edition=4.2.0, implementation-config-variant=VARIANT-PRE-COMPILE
    OsInclude: OsIncludeFileName=out.h
    OsOS: OsStackMonitoring=true, OsUseGetServiceId=true, OsUseParameterAccess=true, OsStatus=EXTENDED, OsScalabilityClass=SC1
      OsHooks: OsErrorHook=false, OsPostTaskHook=false, OsPreTaskHook=false, OsProtectionHook=false, OsShutdownHook=false, OsStartupHook=true
      OsHookStack: OsHookStackSize=AKTSP_HOOK_STACK_SIZE
      OsOsStack: OsOsStackSize=AKTSP_OS_STACK_SIZE, OsOsStackStartAddress=aktg_os_stack+AKTSP_BUFFER_STACK_SIZE
    MainTask (OsTask):
      OsTaskActivation = 1
      OsTaskPriority = 0
      OsTaskStackSize = AKTSP_TASK_STACK_SIZE
      OsTaskSchedule = FULL
      OsTaskResourceRef = DummyResource
      OsTaskEventRef = DummyEvent
    DummyTask (OsTask): OsTaskActivation=1, OsTaskPriority=15, OsTaskStackSize=AKTSP_TASK_STACK_SIZE, OsTaskSchedule=FULL, OsTaskResourceRef=DummyResource
    DummyResource (OsResource): OsResourceProperty=STANDARD
    DummyEvent (OsEvent)
    TASK1 (OsTask): OsTaskActivation=1, OsTaskPriority=10, OsTaskStackSize=AKTSP_TASK_STACK_SIZE, OsTaskStackStartAddress=aktg_stack[0], OsTaskSchedule=NON
      OsTaskAutostart: OsTaskAppModeRef=autostaMode
    TASK2 (OsTask): OsTaskActivation=1, OsTaskPriority=11, OsTaskStackSize=AKTSP_TASK_STACK_SIZE, OsTaskStackStartAddress=aktg_stack[1], OsTaskSchedule=NON
    ALARM1 (OsAlarm): OsAlarmCounterRef=COUNTER1
      OsAlarmAction
        OsAlarmActivateTask: OsAlarmActivateTaskRef=TASK3
      OsAlarmAutostart: OsAlarmAlarmTime=3, OsAlarmCycleTime=0, OsAlarmAutostartType=ABSOLUTE, OsAlarmAppModeRef=autostaMode
    ALARM2 (OsAlarm): OsAlarmCounterRef=COUNTER1
      OsAlarmAction
        OsAlarmActivateTask: OsAlarmActivateTaskRef=TASK4
      OsAlarmAutostart: OsAlarmAlarmTime=3, OsAlarmCycleTime=0, OsAlarmAutostartType=RELATIVE, OsAlarmAppModeRef=autostaMode
    SCHEDULE_TABLE1 (OsScheduleTable): OsScheduleTableDuration=11, OsScheduleTableRepeating=false, OsScheduleTableCounterRef=COUNTER1
      OsScheduleTableExpiryPoint_0 (OsScheduleTableExpiryPoint): OsScheduleTblExpPointOffset=3
        OsScheduleTableTaskActivation_0 (OsScheduleTableTaskActivation): OsScheduleTableActivateTaskRef=TASK3
      OsScheduleTableSync: OsScheduleTblSyncStrategy=IMPLICIT
      OsScheduleTableAutostart: OsScheduleTableStartValue=0, OsScheduleTableAutostartType=ABSOLUTE, OsScheduleTableAppModeRef=autostaMode
    SCHEDULE_TABLE2 (OsScheduleTable): OsScheduleTableDuration=5, OsScheduleTableRepeating=false, OsScheduleTableCounterRef=COUNTER1
      OsScheduleTableExpiryPoint_0 (OsScheduleTableExpiryPoint): OsScheduleTblExpPointOffset=2
        OsScheduleTableTaskActivation_0 (OsScheduleTableTaskActivation): OsScheduleTableActivateTaskRef=TASK4
      OsScheduleTableSync: OsScheduleTblSyncStrategy=NONE
      OsScheduleTableAutostart: OsScheduleTableStartValue=1, OsScheduleTableAutostartType=RELATIVE, OsScheduleTableAppModeRef=autostaMode
    COUNTER1 (OsCounter): OsCounterMaxAllowedValue=10, OsCounterMinCycle=2, OsCounterTicksPerBase=1, OsCounterType=SOFTWARE
    TASK3 (OsTask): OsTaskActivation=1, OsTaskPriority=11, OsTaskStackSize=AKTSP_TASK_STACK_SIZE, OsTaskStackStartAddress=aktg_stack[2], OsTaskSchedule=NON
    TASK4 (OsTask): OsTaskActivation=1, OsTaskPriority=11, OsTaskStackSize=AKTSP_TASK_STACK_SIZE, OsTaskStackStartAddress=aktg_stack[3], OsTaskSchedule=NON
    autostaMode (OsAppMode)
    DUMMY_C2ISR (OsIsr):
      OsIsrInterruptNumber = AKTSP_INTNO_E
      OsIsrInterruptPriority = 4
      OsIsrStackSize = AKTSP_C2ISR_STACK_SIZE
      OsIsrCategory = CATEGORY_2
      OsIsrInterruptSource = ENABLE
