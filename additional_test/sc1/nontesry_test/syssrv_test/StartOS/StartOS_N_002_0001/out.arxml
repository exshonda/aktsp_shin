AUTOSAR XML (schema 4-0-3)
package /Os
  module config Os: ecuc-def-edition=4.2.0, implementation-config-variant=VARIANT-PRE-COMPILE
    OsInclude: OsIncludeFileName=out.h
    MainApp (OsAppMode)
    OsOS: OsStackMonitoring=true, OsUseGetServiceId=true, OsUseParameterAccess=true, OsStatus=EXTENDED, OsScalabilityClass=SC1
      OsHooks: OsErrorHook=false, OsPostTaskHook=false, OsPreTaskHook=false, OsProtectionHook=false, OsShutdownHook=false, OsStartupHook=true
      OsHookStack: OsHookStackSize=AKTSP_HOOK_STACK_SIZE
      OsOsStack: OsOsStackSize=AKTSP_OS_STACK_SIZE, OsOsStackStartAddress=aktg_os_stack+AKTSP_BUFFER_STACK_SIZE
    MainTask (OsTask):
      OsTaskActivation = 1
      OsTaskPriority = 0
      OsTaskStackSize = AKTSP_TASK_STACK_SIZE
      OsTaskSchedule = FULL
      OsTaskResourceRef = DummyResource
      OsTaskEventRef = DummyEvent
      OsTaskAutostart: OsTaskAppModeRef=MainApp
    DummyTask (OsTask): OsTaskActivation=1, OsTaskPriority=15, OsTaskStackSize=AKTSP_TASK_STACK_SIZE, OsTaskSchedule=FULL, OsTaskResourceRef=DummyResource
    DummyResource (OsResource): OsResourceProperty=STANDARD
    DummyEvent (OsEvent)
    AKTG_C2ISR_COMMON_17 (OsIsr):
      OsIsrInterruptNumber = 17
      OsIsrInterruptPriority = 1
      OsIsrStackSize = AKTSP_C2ISR_STACK_SIZE
      OsIsrCategory = CATEGORY_2
      OsIsrInterruptSource = ENABLE
      OsIsrResourceRef = RESOURCE1
    TASK1 (OsTask):
      OsTaskActivation = 1
      OsTaskPriority = 5
      OsTaskStackSize = 592
      OsTaskStackStartAddress = aktg_stack[0]
      OsTaskSchedule = FULL
      OsTaskResourceRef = RESOURCE1
      OsTaskEventRef = EVENT1
    ALARM1 (OsAlarm): OsAlarmCounterRef=COUNTER1
      OsAlarmAction
        OsAlarmActivateTask: OsAlarmActivateTaskRef=TASK1
    SCHEDULE_TABLE1 (OsScheduleTable): OsScheduleTableDuration=5, OsScheduleTableRepeating=false, OsScheduleTableCounterRef=COUNTER1
      OsScheduleTableExpiryPoint_0 (OsScheduleTableExpiryPoint): OsScheduleTblExpPointOffset=3
        OsScheduleTableTaskActivation_0 (OsScheduleTableTaskActivation): OsScheduleTableActivateTaskRef=TASK1
      OsScheduleTableSync: OsScheduleTblSyncStrategy=NONE
    COUNTER1 (OsCounter): OsCounterMaxAllowedValue=10, OsCounterMinCycle=2, OsCounterTicksPerBase=1, OsCounterType=SOFTWARE
    RESOURCE1 (OsResource): OsResourceProperty=STANDARD
    EVENT1 (OsEvent)
