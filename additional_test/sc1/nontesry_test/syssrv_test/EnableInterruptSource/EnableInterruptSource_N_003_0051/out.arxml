AUTOSAR XML (schema 4-0-3)
package /Os
  module config Os: ecuc-def-edition=4.2.0, implementation-config-variant=VARIANT-PRE-COMPILE
    OsInclude: OsIncludeFileName=out.h
    MainApp (OsAppMode)
    OsOS: OsStackMonitoring=true, OsUseGetServiceId=true, OsUseParameterAccess=true, OsStatus=EXTENDED, OsScalabilityClass=SC1
      OsHooks: OsErrorHook=false, OsPostTaskHook=false, OsPreTaskHook=false, OsProtectionHook=false, OsShutdownHook=false, OsStartupHook=true
      OsHookStack: OsHookStackSize=AKTSP_HOOK_STACK_SIZE
      OsOsStack: OsOsStackSize=AKTSP_OS_STACK_SIZE, OsOsStackStartAddress=aktg_os_stack+AKTSP_BUFFER_STACK_SIZE
    MainTask (OsTask):
      OsTaskActivation = 1
      OsTaskPriority = 0
      OsTaskStackSize = AKTSP_TASK_STACK_SIZE
      OsTaskSchedule = FULL
      OsTaskResourceRef = DummyResource
      OsTaskEventRef = DummyEvent
      OsTaskAutostart: OsTaskAppModeRef=MainApp
    DummyTask (OsTask): OsTaskActivation=1, OsTaskPriority=15, OsTaskStackSize=AKTSP_TASK_STACK_SIZE, OsTaskSchedule=FULL, OsTaskResourceRef=DummyResource
    DummyResource (OsResource): OsResourceProperty=STANDARD
    DummyEvent (OsEvent)
    AKTG_C2ISR_COMMON_AKTSP_INTNO_E (OsIsr):
      OsIsrInterruptNumber = AKTSP_INTNO_E
      OsIsrInterruptPriority = 4
      OsIsrStackSize = AKTSP_C2ISR_STACK_SIZE
      OsIsrCategory = CATEGORY_2
      OsIsrInterruptSource = ENABLE
    AKTG_C2ISR_COMMON_AKTSP_INTNO_F (OsIsr):
      OsIsrInterruptNumber = AKTSP_INTNO_F
      OsIsrInterruptPriority = 3
      OsIsrStackSize = AKTSP_C2ISR_STACK_SIZE
      OsIsrCategory = CATEGORY_2
      OsIsrInterruptSource = ENABLE
    TASK1 (OsTask): OsTaskActivation=1, OsTaskPriority=10, OsTaskStackSize=AKTSP_TASK_STACK_SIZE, OsTaskStackStartAddress=aktg_stack[0], OsTaskSchedule=FULL
      OsTaskAutostart: OsTaskAppModeRef=MainApp
