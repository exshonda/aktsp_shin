AUTOSAR XML (schema 4-0-3)
package /Os
  module config Os: ecuc-def-edition=4.0.3, implementation-config-variant=VARIANT-PRE-COMPILE
    OsInclude: OsIncludeFileName=out.h
    MainApp (OsAppMode)
    OsOS: OsStackMonitoring=true, OsStatus=EXTENDED, OsUseGetServiceId=true, OsUseParameterAccess=true, OsScalabilityClass=SC1
      OsHooks: OsErrorHook=true, OsPostTaskHook=false, OsPreTaskHook=false, OsProtectionHook=false, OsShutdownHook=false, OsStartupHook=false
      OsHookStack: OsHookStackSize=AKTSP_HOOK_STACK_SIZE
      OsOsStack: OsOsStackSize=AKTSP_OS_STACK_SIZE, OsOsStackStartAddress=aktg_os_stack+AKTSP_BUFFER_STACK_SIZE
    MainTask (OsTask):
      OsTaskActivation = 1
      OsTaskPriority = 0
      OsTaskSchedule = FULL
      OsTaskStackSize = AKTSP_TASK_STACK_SIZE
      OsTaskResourceRef = DummyResource
      OsTaskEventRef = DummyEvent
      OsTaskAutostart: OsTaskAppModeRef=MainApp
    DummyTask (OsTask): OsTaskActivation=1, OsTaskPriority=15, OsTaskSchedule=FULL, OsTaskStackSize=AKTSP_TASK_STACK_SIZE, OsTaskResourceRef=DummyResource
    DummyResource (OsResource): OsResourceProperty=STANDARD
    DummyEvent (OsEvent)
    TASK1 (OsTask): OsTaskActivation=1, OsTaskPriority=10, OsTaskSchedule=FULL, OsTaskStackSize=AKTSP_TASK_STACK_SIZE, OsTaskStackStartAddress=aktg_stack[0]
    ALARM1 (OsAlarm): OsAlarmCounterRef=COUNTER1
      OsAlarmAction
        OsAlarmIncrementCounter: OsAlarmIncrementCounterRef=COUNTER2
    COUNTER1 (OsCounter): OsCounterMaxAllowedValue=10, OsCounterMinCycle=2, OsCounterTicksPerBase=1, OsCounterType=SOFTWARE
    COUNTER2 (OsCounter): OsCounterMaxAllowedValue=50, OsCounterMinCycle=4, OsCounterTicksPerBase=1, OsCounterType=SOFTWARE
