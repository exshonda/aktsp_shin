AUTOSAR XML (schema 4-0-2)
package /Ecuc
  module config Os
    containers atk2-header-file=out.h:
      MainApp (OsAppMode)
      OsOS: OsStackMonitoring=true, OsStatus=EXTENDED, OsUseGetServiceId=true, OsUseParameterAccess=true
        OsHooks: OsErrorHook=true, OsPostTaskHook=true, OsPreTaskHook=true, OsProtectionHook=true, OsShutdownHook=false, OsStartupHook=false
        OsHookStack: OsHookStackSize=AKTSP_HOOK_STACK_SIZE
      3 x OsAppMode:
        APPLICATION_MODE{1..3}
      40 x OsTask:
        MainTask: OsTaskActivation=1, OsTaskPriority=0, OsTaskSchedule=FULL, OsTaskStackSize=AKTSP_TASK_STACK_SIZE, OsTaskResourceRef=DummyResource, OsTaskEventRef=DummyEvent
          OsTaskAutostart: OsTaskAppModeRef=MainApp
        DummyTask: OsTaskActivation=1, OsTaskPriority=15, OsTaskSchedule=FULL, OsTaskStackSize=AKTSP_TASK_STACK_SIZE, OsTaskResourceRef=DummyResource
        TaskPri0b: OsTaskActivation=1, OsTaskPriority=0, OsTaskSchedule=FULL, OsTaskStackSize=AKTSP_TASK_STACK_SIZE, OsTaskSystemStackSize=AKTSP_TASK_STACK_SIZE
        TaskPri12b: OsTaskActivation=1, OsTaskPriority=12, OsTaskSchedule=FULL, OsTaskStackSize=AKTSP_TASK_STACK_SIZE, OsTaskSystemStackSize=AKTSP_TASK_STACK_SIZE
        TaskPri0c: OsTaskActivation=1, OsTaskPriority=0, OsTaskSchedule=FULL, OsTaskStackSize=AKTSP_TASK_STACK_SIZE, OsTaskSystemStackSize=AKTSP_TASK_STACK_SIZE
        TaskPri9b: OsTaskActivation=1, OsTaskPriority=9, OsTaskSchedule=NON, OsTaskStackSize=AKTSP_TASK_STACK_SIZE, OsTaskSystemStackSize=AKTSP_TASK_STACK_SIZE, OsTaskResourceRef=ResourceA
        TaskPri12c: OsTaskActivation=1, OsTaskPriority=12, OsTaskSchedule=FULL, OsTaskStackSize=AKTSP_TASK_STACK_SIZE, OsTaskSystemStackSize=AKTSP_TASK_STACK_SIZE
        TaskPri10b: OsTaskActivation=1, OsTaskPriority=10, OsTaskSchedule=FULL, OsTaskStackSize=AKTSP_TASK_STACK_SIZE, OsTaskSystemStackSize=AKTSP_TASK_STACK_SIZE
        TaskPri6a: OsTaskActivation=1, OsTaskPriority=6, OsTaskSchedule=FULL, OsTaskStackSize=AKTSP_TASK_STACK_SIZE, OsTaskSystemStackSize=AKTSP_TASK_STACK_SIZE
        TaskPri7b: OsTaskActivation=1, OsTaskPriority=7, OsTaskSchedule=FULL, OsTaskStackSize=AKTSP_TASK_STACK_SIZE, OsTaskSystemStackSize=AKTSP_TASK_STACK_SIZE
        TaskPri6b: OsTaskActivation=1, OsTaskPriority=6, OsTaskSchedule=FULL, OsTaskStackSize=AKTSP_TASK_STACK_SIZE, OsTaskSystemStackSize=AKTSP_TASK_STACK_SIZE, OsTaskResourceRef=ResourceE
        TaskEventA: OsTaskActivation=1, OsTaskPriority=13, OsTaskSchedule=FULL, OsTaskStackSize=AKTSP_TASK_STACK_SIZE, OsTaskSystemStackSize=AKTSP_TASK_STACK_SIZE, OsTaskEventRef=EventA
        TaskSus: OsTaskActivation=1, OsTaskPriority=2, OsTaskSchedule=FULL, OsTaskStackSize=1024, OsTaskSystemStackSize=512, OsTaskResourceRef=ResourceF, OsTaskEventRef=EventF
          OsTaskAutostart: OsTaskAppModeRef=APPLICATION_MODE3
        TaskPri4a: OsTaskActivation=1, OsTaskPriority=4, OsTaskSchedule=FULL, OsTaskStackSize=AKTSP_TASK_STACK_SIZE, OsTaskSystemStackSize=AKTSP_TASK_STACK_SIZE
        TaskPri5b: OsTaskActivation=1, OsTaskPriority=5, OsTaskSchedule=FULL, OsTaskStackSize=AKTSP_TASK_STACK_SIZE, OsTaskSystemStackSize=AKTSP_TASK_STACK_SIZE, OsTaskResourceRef=ResourceInternal
        TaskPri4b: OsTaskActivation=1, OsTaskPriority=4, OsTaskSchedule=FULL, OsTaskStackSize=AKTSP_TASK_STACK_SIZE, OsTaskSystemStackSize=AKTSP_TASK_STACK_SIZE, OsTaskResourceRef=ResourceD
        TaskPri2a: OsTaskActivation=1, OsTaskPriority=2, OsTaskSchedule=FULL, OsTaskStackSize=AKTSP_TASK_STACK_SIZE, OsTaskSystemStackSize=AKTSP_TASK_STACK_SIZE
        TaskPri14a: OsTaskActivation=1, OsTaskPriority=14, OsTaskSchedule=FULL, OsTaskStackSize=AKTSP_TASK_STACK_SIZE, OsTaskSystemStackSize=AKTSP_TASK_STACK_SIZE, OsTaskResourceRef=ResourceC
        TaskPri15b: OsTaskActivation=1, OsTaskPriority=15, OsTaskSchedule=FULL, OsTaskStackSize=AKTSP_TASK_STACK_SIZE, OsTaskSystemStackSize=AKTSP_TASK_STACK_SIZE
        TaskPri2b: OsTaskActivation=1, OsTaskPriority=2, OsTaskSchedule=FULL, OsTaskStackSize=AKTSP_TASK_STACK_SIZE, OsTaskSystemStackSize=AKTSP_TASK_STACK_SIZE
        TaskPri1b: OsTaskActivation=1, OsTaskPriority=1, OsTaskSchedule=FULL, OsTaskStackSize=AKTSP_TASK_STACK_SIZE, OsTaskSystemStackSize=AKTSP_TASK_STACK_SIZE
        TaskPri13b: OsTaskActivation=1, OsTaskPriority=13, OsTaskSchedule=FULL, OsTaskStackSize=AKTSP_TASK_STACK_SIZE, OsTaskSystemStackSize=AKTSP_TASK_STACK_SIZE
        TaskPri11a: OsTaskActivation=1, OsTaskPriority=11, OsTaskSchedule=FULL, OsTaskStackSize=AKTSP_TASK_STACK_SIZE
        TaskResource3: OsTaskActivation=1, OsTaskPriority=7, OsTaskSchedule=FULL, OsTaskStackSize=AKTSP_TASK_STACK_SIZE, OsTaskResourceRef=ResourceA, OsTaskResourceRef=ResourceB, OsTaskResourceRef=ResourceC
        TaskPri9a: OsTaskActivation=1, OsTaskPriority=9, OsTaskSchedule=FULL, OsTaskStackSize=AKTSP_TASK_STACK_SIZE
        TaskPri8a: OsTaskActivation=3, OsTaskPriority=8, OsTaskSchedule=FULL, OsTaskStackSize=AKTSP_TASK_STACK_SIZE
          OsTaskAutostart: OsTaskAppModeRef=APPLICATION_MODE1, OsTaskAppModeRef=APPLICATION_MODE2, OsTaskAppModeRef=MainApp
        TaskPri10a: OsTaskActivation=1, OsTaskPriority=10, OsTaskSchedule=FULL, OsTaskStackSize=AKTSP_TASK_STACK_SIZE
        TaskPri7a: OsTaskActivation=1, OsTaskPriority=7, OsTaskSchedule=FULL, OsTaskStackSize=AKTSP_TASK_STACK_SIZE, OsTaskResourceRef=ResourceInternal
        TaskEventDE: OsTaskActivation=1, OsTaskPriority=4, OsTaskSchedule=FULL, OsTaskStackSize=AKTSP_TASK_STACK_SIZE, OsTaskEventRef=EventD, OsTaskEventRef=EventE
        TaskEventBC: OsTaskActivation=1, OsTaskPriority=9, OsTaskSchedule=FULL, OsTaskStackSize=AKTSP_TASK_STACK_SIZE, OsTaskEventRef=EventB, OsTaskEventRef=EventC
        TaskPri5a: OsTaskActivation=1, OsTaskPriority=5, OsTaskSchedule=FULL, OsTaskStackSize=AKTSP_TASK_STACK_SIZE
        TaskPri3a: OsTaskActivation=1, OsTaskPriority=3, OsTaskSchedule=FULL, OsTaskStackSize=AKTSP_TASK_STACK_SIZE
        TaskPri15a: OsTaskActivation=1, OsTaskPriority=15, OsTaskSchedule=FULL, OsTaskStackSize=AKTSP_TASK_STACK_SIZE, OsTaskAccessingApplication=NON_TRUSTED_OSAP1
        TaskResource1: OsTaskActivation=1, OsTaskPriority=1, OsTaskSchedule=FULL, OsTaskStackSize=AKTSP_TASK_STACK_SIZE, OsTaskResourceRef=ResourceF
        TaskPri1a: OsTaskActivation=1, OsTaskPriority=1, OsTaskSchedule=FULL, OsTaskStackSize=AKTSP_TASK_STACK_SIZE
        TaskPri13a: OsTaskActivation=1, OsTaskPriority=13, OsTaskSchedule=NON, OsTaskStackSize=AKTSP_TASK_STACK_SIZE, OsTaskResourceRef=ResourceB
        TaskPri15c: OsTaskActivation=1, OsTaskPriority=15, OsTaskSchedule=NON, OsTaskStackSize=AKTSP_TASK_STACK_SIZE
        TaskResource2: OsTaskActivation=1, OsTaskPriority=3, OsTaskSchedule=FULL, OsTaskStackSize=AKTSP_TASK_STACK_SIZE, OsTaskResourceRef=ResourceD, OsTaskResourceRef=ResourceE
        TaskPri0a: OsTaskActivation=1, OsTaskPriority=0, OsTaskSchedule=FULL, OsTaskStackSize=AKTSP_TASK_STACK_SIZE
        TaskPri12a: OsTaskActivation=1, OsTaskPriority=12, OsTaskSchedule=FULL, OsTaskStackSize=AKTSP_TASK_STACK_SIZE
      AKTG_C1ISR_COMMON_AKTSP_INTNO_B (OsIsr): OsIsrCategory=CATEGORY_1, OsIsrInterruptNumber=AKTSP_INTNO_B, OsIsrInterruptPriority=7, OsIsrInterruptSource=ENABLE
      AKTG_C2ISR_COMMON_AKTSP_INTNO_F (OsIsr):
        OsIsrCategory = CATEGORY_2
        OsIsrInterruptNumber = AKTSP_INTNO_F
        OsIsrInterruptPriority = 3
        OsIsrInterruptSource = ENABLE
        OsIsrStackSize = AKTSP_C2ISR_STACK_SIZE
      8 x OsResource:
        DummyResource: OsResourceProperty=STANDARD
        ResourceInternal: OsResourceProperty=INTERNAL, OsResourceAccessingApplication=NON_TRUSTED_OSAP1
        ResourceB: OsResourceProperty=STANDARD
        ResourceC: OsResourceProperty=STANDARD
        ResourceD: OsResourceProperty=STANDARD
        ResourceE: OsResourceProperty=STANDARD
        ResourceF: OsResourceProperty=STANDARD
        ResourceA: OsResourceProperty=STANDARD
      7 x OsEvent:
        DummyEvent
        EventA: OsEventMask=1
        EventB: OsEventMask=16
        EventC: OsEventMask=256
        EventD: OsEventMask=4096
        EventE: OsEventMask=65536
        EventF: OsEventMask=1048576
      4 x OsApplication:
        TRUSTED_MAIN_OSAP: OsTrusted=true, OsAppTaskRef=MainTask, OsAppTaskRef=DummyTask
          3 x OsApplicationTrustedFunction, all with OsTrustedFunctionStackSize=AKTSP_STACK_SIZE_FOR_TFN:
            AktspTfnActivateTask: OsTrustedFunctionName=TRUSTED_AktspTfnActivateTask
            AktspTfnSetEvent: OsTrustedFunctionName=TRUSTED_AktspTfnSetEvent
            AktspTfnShutdownOS: OsTrustedFunctionName=TRUSTED_AktspTfnShutdownOS
        NON_TRUSTED_OSAP1: OsTrusted=false, OsAppTaskRef=TaskPri0b, OsAppTaskRef=TaskPri12b, OsAppTaskRef=TaskPri0c, OsAppTaskRef=TaskPri9b, OsAppTaskRef=TaskPri12c, OsAppTaskRef=TaskPri10b, OsAppTaskRef=TaskPri6a, OsAppTaskRef=TaskPri7b, OsAppTaskRef=TaskPri6b, OsAppTaskRef=TaskEventA, OsAppTaskRef=TaskSus, OsAppTaskRef=TaskPri4a, OsAppTaskRef=TaskPri5b, OsAppTaskRef=TaskPri4b, OsAppTaskRef=TaskPri2a, OsAppTaskRef=TaskPri14a, OsAppTaskRef=TaskPri15b, OsAppTaskRef=TaskPri2b, OsAppTaskRef=TaskPri1b, OsAppTaskRef=TaskPri13b
        TRUSTED_OSAP1: OsTrusted=true, OsAppTaskRef=TaskPri11a, OsAppTaskRef=TaskResource3, OsAppTaskRef=TaskPri9a, OsAppTaskRef=TaskPri8a, OsAppTaskRef=TaskPri10a, OsAppTaskRef=TaskPri7a, OsAppTaskRef=TaskEventDE, OsAppTaskRef=TaskEventBC, OsAppTaskRef=TaskPri5a, OsAppTaskRef=TaskPri3a, OsAppTaskRef=TaskPri15a, OsAppTaskRef=TaskResource1, OsAppTaskRef=TaskPri1a, OsAppTaskRef=TaskPri13a, OsAppTaskRef=TaskPri15c, OsAppTaskRef=TaskResource2, OsAppTaskRef=TaskPri0a, OsAppTaskRef=TaskPri12a
        TRUSTED_OSAP5: OsTrusted=true, OsAppIsrRef=AKTG_C1ISR_COMMON_AKTSP_INTNO_B, OsAppIsrRef=AKTG_C2ISR_COMMON_AKTSP_INTNO_F
          VerifyTrustedFunction (OsApplicationTrustedFunction): OsTrustedFunctionName=TRUSTED_VerifyTrustedFunction, OsTrustedFunctionStackSize=AKTSP_STACK_SIZE_FOR_TFN
