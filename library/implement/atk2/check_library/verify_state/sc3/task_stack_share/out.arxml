AUTOSAR XML (schema 4-0-2)
package /Ecuc
  module config Os
    containers atk2-header-file=out.h:
      MainApp (OsAppMode)
      OsOS: OsStackMonitoring=true, OsStatus=EXTENDED, OsUseGetServiceId=true, OsUseParameterAccess=true
        OsHooks: OsErrorHook=true, OsPostTaskHook=true, OsPreTaskHook=true, OsProtectionHook=true, OsShutdownHook=false, OsStartupHook=false
        OsHookStack: OsHookStackSize=AKTSP_HOOK_STACK_SIZE
        OsOsStack: OsOsStackSize=AKTSP_OS_STACK_SIZE, OsOsStackStartAddress=aktg_os_stack
      OsLinkSection: OsLinkSectionName=.stack_section, OsLinkSectionMemoryRegionRef=RAM
      5 x OsTask, all with OsTaskActivation=1, OsTaskSchedule=FULL, OsTaskStackSize=AKTSP_TASK_STACK_SIZE:
        MainTask: OsTaskPriority=0, OsTaskResourceRef=DummyResource, OsTaskEventRef=DummyEvent
          OsTaskAutostart: OsTaskAppModeRef=MainApp
        DummyTask: OsTaskPriority=15, OsTaskResourceRef=DummyResource
        Task2: OsTaskPriority=5, OsTaskStackStartAddress=aktg_ustack[1], OsTaskSystemStackSize=AKTSP_TASK_STACK_SIZE, OsTaskSystemStackStartAddress=aktg_sstack[1]
        NonTrustedTask: OsTaskPriority=6, OsTaskStackStartAddress=aktg_ustack[0], OsTaskSystemStackSize=AKTSP_TASK_STACK_SIZE, OsTaskSystemStackStartAddress=aktg_sstack[0]
        Task1: OsTaskPriority=2, OsTaskStackStartAddress=aktg_stack[0]
      AKTG_C1ISR_COMMON_AKTSP_INTNO_B (OsIsr): OsIsrCategory=CATEGORY_1, OsIsrInterruptNumber=AKTSP_INTNO_B, OsIsrInterruptPriority=7, OsIsrInterruptSource=ENABLE
      AKTG_C2ISR_COMMON_AKTSP_INTNO_F (OsIsr):
        OsIsrCategory = CATEGORY_2
        OsIsrInterruptNumber = AKTSP_INTNO_F
        OsIsrInterruptPriority = 3
        OsIsrInterruptSource = ENABLE
        OsIsrStackSize = AKTSP_C2ISR_STACK_SIZE
      TrustedTask (OsTask): OsTaskActivation=1, OsTaskPriority=5, OsTaskSchedule=FULL, OsTaskStackSize=AKTSP_TASK_STACK_SIZE, OsTaskStackStartAddress=aktg_stack[1]
      DummyResource (OsResource): OsResourceProperty=STANDARD
      DummyEvent (OsEvent)
      5 x OsApplication:
        TRUSTED_MAIN_OSAP: OsTrusted=true, OsAppTaskRef=MainTask, OsAppTaskRef=DummyTask
          3 x OsApplicationTrustedFunction, all with OsTrustedFunctionStackSize=AKTSP_STACK_SIZE_FOR_TFN:
            AktspTfnActivateTask: OsTrustedFunctionName=TRUSTED_AktspTfnActivateTask
            AktspTfnSetEvent: OsTrustedFunctionName=TRUSTED_AktspTfnSetEvent
            AktspTfnShutdownOS: OsTrustedFunctionName=TRUSTED_AktspTfnShutdownOS
        NON_TRUSTED_OSAP1: OsTrusted=false, OsAppTaskRef=Task2
        NON_TRUSTED_OSAP5: OsTrusted=false, OsAppTaskRef=NonTrustedTask
        TRUSTED_OSAP1: OsTrusted=true, OsAppTaskRef=Task1
        TRUSTED_OSAP5: OsTrusted=true, OsAppIsrRef=AKTG_C1ISR_COMMON_AKTSP_INTNO_B, OsAppIsrRef=AKTG_C2ISR_COMMON_AKTSP_INTNO_F, OsAppTaskRef=TrustedTask
          VerifyTrustedFunction (OsApplicationTrustedFunction): OsTrustedFunctionName=TRUSTED_VerifyTrustedFunction, OsTrustedFunctionStackSize=AKTSP_STACK_SIZE_FOR_TFN
