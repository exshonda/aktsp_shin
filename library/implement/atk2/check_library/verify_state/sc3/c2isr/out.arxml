AUTOSAR XML (schema 4-0-2)
package /Ecuc
  module config Os
    containers atk2-header-file=out.h:
      MainApp (OsAppMode)
      OsOS: OsStackMonitoring=true, OsStatus=EXTENDED, OsUseGetServiceId=true, OsUseParameterAccess=true
        OsHooks: OsErrorHook=true, OsPostTaskHook=true, OsPreTaskHook=true, OsProtectionHook=true, OsShutdownHook=false, OsStartupHook=false
        OsHookStack: OsHookStackSize=AKTSP_HOOK_STACK_SIZE
      3 x OsTask, all with OsTaskActivation=1, OsTaskSchedule=FULL, OsTaskStackSize=AKTSP_TASK_STACK_SIZE:
        MainTask: OsTaskPriority=0, OsTaskResourceRef=DummyResource, OsTaskEventRef=DummyEvent
          OsTaskAutostart: OsTaskAppModeRef=MainApp
        DummyTask: OsTaskPriority=15, OsTaskResourceRef=DummyResource
        NonTrustedTask: OsTaskPriority=6, OsTaskSystemStackSize=AKTSP_TASK_STACK_SIZE
      4 x OsIsr, all with OsIsrInterruptSource=ENABLE:
        AKTG_C2ISR_COMMON_AKTSP_INTNO_E: OsIsrCategory=CATEGORY_2, OsIsrInterruptNumber=AKTSP_INTNO_E, OsIsrInterruptPriority=4, OsIsrStackSize=AKTSP_C2ISR_STACK_SIZE, OsIsrAccessingApplication=NON_TRUSTED_OSAP5, OsIsrResourceRef=ResourceA, OsIsrResourceRef=ResourceB
        AKTG_C2ISR_COMMON_AKTSP_INTNO_F: OsIsrCategory=CATEGORY_2, OsIsrInterruptNumber=AKTSP_INTNO_F, OsIsrInterruptPriority=3, OsIsrStackSize=AKTSP_C2ISR_STACK_SIZE, OsIsrResourceRef=ResourceC
        AKTG_C2ISR_COMMON_AKTSP_INTNO_I: OsIsrCategory=CATEGORY_2, OsIsrInterruptNumber=AKTSP_INTNO_I, OsIsrInterruptPriority=2, OsIsrStackSize=256, OsIsrResourceRef=ResourceA
        AKTG_C1ISR_COMMON_AKTSP_INTNO_B: OsIsrCategory=CATEGORY_1, OsIsrInterruptNumber=AKTSP_INTNO_B, OsIsrInterruptPriority=7
      TrustedTask (OsTask): OsTaskActivation=1, OsTaskPriority=5, OsTaskSchedule=FULL, OsTaskStackSize=AKTSP_TASK_STACK_SIZE, OsTaskResourceRef=ResourceC
      TaskDummy1 (OsTask): OsTaskActivation=1, OsTaskPriority=1, OsTaskSchedule=FULL, OsTaskStackSize=AKTSP_TASK_STACK_SIZE, OsTaskResourceRef=ResourceB
      4 x OsResource, all with OsResourceProperty=STANDARD:
        DummyResource
        ResourceB
        ResourceC: OsResourceAccessingApplication=NON_TRUSTED_OSAP5
        ResourceA
      DummyEvent (OsEvent)
      5 x OsApplication:
        TRUSTED_MAIN_OSAP: OsTrusted=true, OsAppTaskRef=MainTask, OsAppTaskRef=DummyTask
          3 x OsApplicationTrustedFunction, all with OsTrustedFunctionStackSize=AKTSP_STACK_SIZE_FOR_TFN:
            AktspTfnActivateTask: OsTrustedFunctionName=TRUSTED_AktspTfnActivateTask
            AktspTfnSetEvent: OsTrustedFunctionName=TRUSTED_AktspTfnSetEvent
            AktspTfnShutdownOS: OsTrustedFunctionName=TRUSTED_AktspTfnShutdownOS
        NON_TRUSTED_OSAP5: OsTrusted=false, OsAppTaskRef=NonTrustedTask
        TRUSTED_OSAP1: OsTrusted=true, OsAppIsrRef=AKTG_C2ISR_COMMON_AKTSP_INTNO_E
        TRUSTED_OSAP2: OsTrusted=true, OsAppIsrRef=AKTG_C2ISR_COMMON_AKTSP_INTNO_F, OsAppIsrRef=AKTG_C2ISR_COMMON_AKTSP_INTNO_I
        TRUSTED_OSAP5: OsTrusted=true, OsAppIsrRef=AKTG_C1ISR_COMMON_AKTSP_INTNO_B, OsAppTaskRef=TrustedTask, OsAppTaskRef=TaskDummy1
          VerifyTrustedFunction (OsApplicationTrustedFunction): OsTrustedFunctionName=TRUSTED_VerifyTrustedFunction, OsTrustedFunctionStackSize=AKTSP_STACK_SIZE_FOR_TFN
