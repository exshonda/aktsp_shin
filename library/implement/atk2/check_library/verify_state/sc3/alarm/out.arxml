AUTOSAR XML (schema 4-0-2)
package /Ecuc
  module config Os
    containers atk2-header-file=out.h:
      MainApp (OsAppMode)
      OsOS: OsStackMonitoring=true, OsStatus=EXTENDED, OsUseGetServiceId=true, OsUseParameterAccess=true
        OsHooks: OsErrorHook=true, OsPostTaskHook=true, OsPreTaskHook=true, OsProtectionHook=true, OsShutdownHook=false, OsStartupHook=false
        OsHookStack: OsHookStackSize=AKTSP_HOOK_STACK_SIZE
      3 x OsAppMode:
        APPLICATION_MODE{1..3}
      MainTask (OsTask):
        OsTaskActivation = 1
        OsTaskPriority = 0
        OsTaskSchedule = FULL
        OsTaskStackSize = AKTSP_TASK_STACK_SIZE
        OsTaskResourceRef = DummyResource
        OsTaskEventRef = DummyEvent
        OsTaskAutostart: OsTaskAppModeRef=MainApp
      DummyTask (OsTask): OsTaskActivation=1, OsTaskPriority=15, OsTaskSchedule=FULL, OsTaskStackSize=AKTSP_TASK_STACK_SIZE, OsTaskResourceRef=DummyResource
      AlarmSetEvent (OsAlarm): OsAlarmCounterRef=Counter
        OsAlarmAction
          OsAlarmSetEvent: OsAlarmSetEventTaskRef=TaskSetEvent, OsAlarmSetEventRef=Event1
        OsAlarmAutostart:
          OsAlarmAlarmTime = 1
          OsAlarmCycleTime = 8
          OsAlarmAutostartType = RELATIVE
          OsAlarmAppModeRef = APPLICATION_MODE2
          OsAlarmAppModeRef = APPLICATION_MODE3
          OsAlarmAppModeRef = MainApp
      CounterInc (OsCounter): OsCounterMaxAllowedValue=10, OsCounterMinCycle=2, OsCounterTicksPerBase=1, OsCounterType=SOFTWARE
      AlarmUnset (OsAlarm): OsAlarmCounterRef=Counter
        OsAlarmAction
          OsAlarmActivateTask: OsAlarmActivateTaskRef=TaskUnset
      TaskUnset (OsTask): OsTaskActivation=1, OsTaskPriority=2, OsTaskSchedule=FULL, OsTaskStackSize=AKTSP_TASK_STACK_SIZE, OsTaskSystemStackSize=AKTSP_TASK_STACK_SIZE
      TaskActTask (OsTask): OsTaskActivation=1, OsTaskPriority=6, OsTaskSchedule=FULL, OsTaskStackSize=AKTSP_TASK_STACK_SIZE, OsTaskSystemStackSize=AKTSP_TASK_STACK_SIZE
      Counter (OsCounter): OsCounterMaxAllowedValue=8, OsCounterMinCycle=1, OsCounterTicksPerBase=1, OsCounterType=SOFTWARE
      NonTrustedTask (OsTask): OsTaskActivation=1, OsTaskPriority=6, OsTaskSchedule=FULL, OsTaskStackSize=AKTSP_TASK_STACK_SIZE, OsTaskSystemStackSize=AKTSP_TASK_STACK_SIZE
      AlarmIncCounter (OsAlarm): OsAlarmCounterRef=Counter
        OsAlarmAction
          OsAlarmIncrementCounter: OsAlarmIncrementCounterRef=CounterInc
      AlarmActTask (OsAlarm): OsAlarmCounterRef=Counter, OsAlarmAccessingApplication=NON_TRUSTED_OSAP5
        OsAlarmAction
          OsAlarmActivateTask: OsAlarmActivateTaskRef=TaskActTask
        OsAlarmAutostart: OsAlarmAlarmTime=2, OsAlarmCycleTime=5, OsAlarmAutostartType=ABSOLUTE, OsAlarmAppModeRef=APPLICATION_MODE1, OsAlarmAppModeRef=MainApp
      TaskSetEvent (OsTask):
        OsTaskActivation = 1
        OsTaskPriority = 2
        OsTaskSchedule = FULL
        OsTaskStackSize = AKTSP_TASK_STACK_SIZE
        OsTaskAccessingApplication = NON_TRUSTED_OSAP1
        OsTaskEventRef = Event1
      AKTG_C1ISR_COMMON_AKTSP_INTNO_B (OsIsr): OsIsrCategory=CATEGORY_1, OsIsrInterruptNumber=AKTSP_INTNO_B, OsIsrInterruptPriority=7, OsIsrInterruptSource=ENABLE
      AKTG_C2ISR_COMMON_AKTSP_INTNO_F (OsIsr):
        OsIsrCategory = CATEGORY_2
        OsIsrInterruptNumber = AKTSP_INTNO_F
        OsIsrInterruptPriority = 3
        OsIsrInterruptSource = ENABLE
        OsIsrStackSize = AKTSP_C2ISR_STACK_SIZE
      TrustedTask (OsTask): OsTaskActivation=1, OsTaskPriority=5, OsTaskSchedule=FULL, OsTaskStackSize=AKTSP_TASK_STACK_SIZE
      DummyResource (OsResource): OsResourceProperty=STANDARD
      DummyEvent (OsEvent)
      Event1 (OsEvent)
      5 x OsApplication:
        TRUSTED_MAIN_OSAP: OsTrusted=true, OsAppTaskRef=MainTask, OsAppTaskRef=DummyTask
          3 x OsApplicationTrustedFunction, all with OsTrustedFunctionStackSize=AKTSP_STACK_SIZE_FOR_TFN:
            AktspTfnActivateTask: OsTrustedFunctionName=TRUSTED_AktspTfnActivateTask
            AktspTfnSetEvent: OsTrustedFunctionName=TRUSTED_AktspTfnSetEvent
            AktspTfnShutdownOS: OsTrustedFunctionName=TRUSTED_AktspTfnShutdownOS
        NON_TRUSTED_OSAP1: OsTrusted=false, OsAppAlarmRef=AlarmSetEvent, OsAppCounterRef=CounterInc, OsAppAlarmRef=AlarmUnset, OsAppTaskRef=TaskUnset, OsAppTaskRef=TaskActTask, OsAppCounterRef=Counter
        NON_TRUSTED_OSAP5: OsTrusted=false, OsAppTaskRef=NonTrustedTask
        TRUSTED_OSAP1: OsTrusted=true, OsAppAlarmRef=AlarmIncCounter, OsAppAlarmRef=AlarmActTask, OsAppTaskRef=TaskSetEvent
        TRUSTED_OSAP5: OsTrusted=true, OsAppIsrRef=AKTG_C1ISR_COMMON_AKTSP_INTNO_B, OsAppIsrRef=AKTG_C2ISR_COMMON_AKTSP_INTNO_F, OsAppTaskRef=TrustedTask
          VerifyTrustedFunction (OsApplicationTrustedFunction): OsTrustedFunctionName=TRUSTED_VerifyTrustedFunction, OsTrustedFunctionStackSize=AKTSP_STACK_SIZE_FOR_TFN
