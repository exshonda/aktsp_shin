AUTOSAR XML (schema 4-0-2)
package /Ecuc
  module config Os
    containers atk2-header-file=out.h:
      MainApp (OsAppMode)
      OsOS: OsStackMonitoring=true, OsStatus=EXTENDED, OsUseGetServiceId=true, OsUseParameterAccess=true
        OsHooks: OsErrorHook=true, OsPostTaskHook=true, OsPreTaskHook=true, OsProtectionHook=true, OsShutdownHook=false, OsStartupHook=false
        OsHookStack: OsHookStackSize=AKTSP_HOOK_STACK_SIZE
      MainTask (OsTask):
        OsTaskActivation = 1
        OsTaskPriority = 0
        OsTaskSchedule = FULL
        OsTaskStackSize = AKTSP_TASK_STACK_SIZE
        OsTaskResourceRef = DummyResource
        OsTaskEventRef = DummyEvent
        OsTaskAutostart: OsTaskAppModeRef=MainApp
      DummyTask (OsTask): OsTaskActivation=1, OsTaskPriority=15, OsTaskSchedule=FULL, OsTaskStackSize=AKTSP_TASK_STACK_SIZE, OsTaskResourceRef=DummyResource
      AKTG_C2ISR_FOR_HWCNT (OsIsr):
        OsIsrCategory = CATEGORY_2
        OsIsrInterruptNumber = AKTSP_INTNO_HWCNT
        OsIsrInterruptPriority = 5
        OsIsrInterruptSource = ENABLE
        OsIsrStackSize = AKTSP_C2ISR_STACK_SIZE
      3 x OsCounter, all with OsCounterTicksPerBase=1:
        DUMMY_HARDWARE_COUNTER: OsCounterMaxAllowedValue=10, OsCounterMinCycle=2, OsCounterType=HARDWARE, OsSecondsPerTick=1.0, OsCounterISRRef=AKTG_C2ISR_FOR_HWCNT
        Counter2: OsCounterMaxAllowedValue=10, OsCounterMinCycle=2, OsCounterType=SOFTWARE
        Counter3: OsCounterMaxAllowedValue=15, OsCounterMinCycle=3, OsCounterType=SOFTWARE
      NonTrustedTask (OsTask): OsTaskActivation=1, OsTaskPriority=6, OsTaskSchedule=FULL, OsTaskStackSize=AKTSP_TASK_STACK_SIZE, OsTaskSystemStackSize=AKTSP_TASK_STACK_SIZE
      TaskActTask (OsTask): OsTaskActivation=1, OsTaskPriority=6, OsTaskSchedule=FULL, OsTaskStackSize=AKTSP_TASK_STACK_SIZE, OsTaskSystemStackSize=AKTSP_TASK_STACK_SIZE
      AlarmActTask (OsAlarm): OsAlarmCounterRef=Counter1
        OsAlarmAction
          OsAlarmActivateTask: OsAlarmActivateTaskRef=TaskActTask
      Counter1 (OsCounter): OsCounterMaxAllowedValue=8, OsCounterMinCycle=1, OsCounterTicksPerBase=1, OsCounterType=SOFTWARE, OsCounterAccessingApplication=NON_TRUSTED_OSAP1
      AKTG_C1ISR_COMMON_AKTSP_INTNO_B (OsIsr): OsIsrCategory=CATEGORY_1, OsIsrInterruptNumber=AKTSP_INTNO_B, OsIsrInterruptPriority=7, OsIsrInterruptSource=ENABLE
      AKTG_C2ISR_COMMON_AKTSP_INTNO_F (OsIsr):
        OsIsrCategory = CATEGORY_2
        OsIsrInterruptNumber = AKTSP_INTNO_F
        OsIsrInterruptPriority = 3
        OsIsrInterruptSource = ENABLE
        OsIsrStackSize = AKTSP_C2ISR_STACK_SIZE
      TrustedTask (OsTask): OsTaskActivation=1, OsTaskPriority=5, OsTaskSchedule=FULL, OsTaskStackSize=AKTSP_TASK_STACK_SIZE
      DummyResource (OsResource): OsResourceProperty=STANDARD
      DummyEvent (OsEvent)
      5 x OsApplication:
        TRUSTED_MAIN_OSAP: OsTrusted=true, OsAppTaskRef=MainTask, OsAppTaskRef=DummyTask, OsAppIsrRef=AKTG_C2ISR_FOR_HWCNT, OsAppCounterRef=DUMMY_HARDWARE_COUNTER
          3 x OsApplicationTrustedFunction, all with OsTrustedFunctionStackSize=AKTSP_STACK_SIZE_FOR_TFN:
            AktspTfnActivateTask: OsTrustedFunctionName=TRUSTED_AktspTfnActivateTask
            AktspTfnSetEvent: OsTrustedFunctionName=TRUSTED_AktspTfnSetEvent
            AktspTfnShutdownOS: OsTrustedFunctionName=TRUSTED_AktspTfnShutdownOS
        NON_TRUSTED_OSAP1: OsTrusted=false, OsAppCounterRef=Counter2, OsAppCounterRef=Counter3
        NON_TRUSTED_OSAP5: OsTrusted=false, OsAppTaskRef=NonTrustedTask, OsAppTaskRef=TaskActTask
        TRUSTED_OSAP1: OsTrusted=true, OsAppAlarmRef=AlarmActTask, OsAppCounterRef=Counter1
        TRUSTED_OSAP5: OsTrusted=true, OsAppIsrRef=AKTG_C1ISR_COMMON_AKTSP_INTNO_B, OsAppIsrRef=AKTG_C2ISR_COMMON_AKTSP_INTNO_F, OsAppTaskRef=TrustedTask
          VerifyTrustedFunction (OsApplicationTrustedFunction): OsTrustedFunctionName=TRUSTED_VerifyTrustedFunction, OsTrustedFunctionStackSize=AKTSP_STACK_SIZE_FOR_TFN
