AUTOSAR XML (schema 4-0-2)
package /Ecuc
  module config Os
    containers atk2-header-file=out.h:
      MainApp (OsAppMode)
      OsOS: OsStackMonitoring=true, OsStatus=EXTENDED, OsUseGetServiceId=true, OsUseParameterAccess=true
        OsHooks: OsErrorHook=true, OsPostTaskHook=true, OsPreTaskHook=true, OsProtectionHook=true, OsShutdownHook=false, OsStartupHook=false
        OsHookStack: OsHookStackSize=AKTSP_HOOK_STACK_SIZE
      12 x OsTask, all with OsTaskActivation=1, OsTaskSchedule=FULL, OsTaskStackSize=AKTSP_TASK_STACK_SIZE:
        MainTask: OsTaskPriority=0, OsTaskResourceRef=DummyResource, OsTaskEventRef=DummyEvent
          OsTaskAutostart: OsTaskAppModeRef=MainApp
        DummyTask: OsTaskPriority=15, OsTaskResourceRef=DummyResource
        TaskDummy5: OsTaskPriority=1, OsTaskSystemStackSize=AKTSP_TASK_STACK_SIZE, OsTaskResourceRef=StandardResUnl
        TaskDummy7: OsTaskPriority=1, OsTaskSystemStackSize=AKTSP_TASK_STACK_SIZE, OsTaskResourceRef=InternalResUnl
        TaskDummy1: OsTaskPriority=3, OsTaskSystemStackSize=AKTSP_TASK_STACK_SIZE, OsTaskResourceRef=StandardResLock
        TaskInternalRes: OsTaskPriority=9, OsTaskSystemStackSize=AKTSP_TASK_STACK_SIZE, OsTaskResourceRef=InternalResLock
        TaskDummy3: OsTaskPriority=7, OsTaskSystemStackSize=AKTSP_TASK_STACK_SIZE, OsTaskResourceRef=StandardResforLnk
        TaskDummy6: OsTaskPriority=1, OsTaskResourceRef=InternalResUnl
        TaskLinkedRes: OsTaskPriority=6, OsTaskResourceRef=StandardResforLnk
        TaskDummy2: OsTaskPriority=5, OsTaskResourceRef=InternalResLock
        TaskDummy4: OsTaskPriority=1, OsTaskResourceRef=StandardResUnl
        TaskStandardRes: OsTaskPriority=2, OsTaskResourceRef=StandardResLock
      AKTG_C1ISR_COMMON_AKTSP_INTNO_B (OsIsr): OsIsrCategory=CATEGORY_1, OsIsrInterruptNumber=AKTSP_INTNO_B, OsIsrInterruptPriority=7, OsIsrInterruptSource=ENABLE
      AKTG_C2ISR_COMMON_AKTSP_INTNO_F (OsIsr):
        OsIsrCategory = CATEGORY_2
        OsIsrInterruptNumber = AKTSP_INTNO_F
        OsIsrInterruptPriority = 3
        OsIsrInterruptSource = ENABLE
        OsIsrStackSize = AKTSP_C2ISR_STACK_SIZE
      8 x OsResource:
        DummyResource: OsResourceProperty=STANDARD
        LinkedResUnl: OsResourceProperty=LINKED, OsResourceLinkedResourceRef=StandardResUnl
        StandardResLock: OsResourceProperty=STANDARD, OsResourceAccessingApplication=NON_TRUSTED_OSAP1
        InternalResLock: OsResourceProperty=INTERNAL, OsResourceAccessingApplication=NON_TRUSTED_OSAP1
        LinkedResLock: OsResourceProperty=LINKED, OsResourceLinkedResourceRef=StandardResforLnk
        StandardResforLnk: OsResourceProperty=STANDARD
        StandardResUnl: OsResourceProperty=STANDARD
        InternalResUnl: OsResourceProperty=INTERNAL, OsResourceAccessingApplication=NON_TRUSTED_OSAP1
      DummyEvent (OsEvent)
      4 x OsApplication:
        TRUSTED_MAIN_OSAP: OsTrusted=true, OsAppTaskRef=MainTask, OsAppTaskRef=DummyTask
          3 x OsApplicationTrustedFunction, all with OsTrustedFunctionStackSize=AKTSP_STACK_SIZE_FOR_TFN:
            AktspTfnActivateTask: OsTrustedFunctionName=TRUSTED_AktspTfnActivateTask
            AktspTfnSetEvent: OsTrustedFunctionName=TRUSTED_AktspTfnSetEvent
            AktspTfnShutdownOS: OsTrustedFunctionName=TRUSTED_AktspTfnShutdownOS
        NON_TRUSTED_OSAP1: OsTrusted=false, OsAppTaskRef=TaskDummy5, OsAppTaskRef=TaskDummy7, OsAppTaskRef=TaskDummy1, OsAppTaskRef=TaskInternalRes, OsAppTaskRef=TaskDummy3
        TRUSTED_OSAP1: OsTrusted=true, OsAppTaskRef=TaskDummy6, OsAppTaskRef=TaskLinkedRes, OsAppTaskRef=TaskDummy2, OsAppTaskRef=TaskDummy4, OsAppTaskRef=TaskStandardRes
        TRUSTED_OSAP5: OsTrusted=true, OsAppIsrRef=AKTG_C1ISR_COMMON_AKTSP_INTNO_B, OsAppIsrRef=AKTG_C2ISR_COMMON_AKTSP_INTNO_F
          VerifyTrustedFunction (OsApplicationTrustedFunction): OsTrustedFunctionName=TRUSTED_VerifyTrustedFunction, OsTrustedFunctionStackSize=AKTSP_STACK_SIZE_FOR_TFN
