AUTOSAR XML (schema 4-0-2)
package /Ecuc
  module config Os
    containers atk2-header-file=out.h:
      MainApp (OsAppMode)
      OsOS: OsStackMonitoring=true, OsStatus=EXTENDED, OsUseGetServiceId=true, OsUseParameterAccess=true
        OsHooks: OsErrorHook=true, OsPostTaskHook=true, OsPreTaskHook=true, OsProtectionHook=true, OsShutdownHook=false, OsStartupHook=false
        OsHookStack: OsHookStackSize=AKTSP_HOOK_STACK_SIZE
      MainTask (OsTask):
        OsTaskActivation = 1
        OsTaskPriority = 0
        OsTaskSchedule = FULL
        OsTaskStackSize = AKTSP_TASK_STACK_SIZE
        OsTaskResourceRef = DummyResource
        OsTaskEventRef = DummyEvent
        OsTaskAutostart: OsTaskAppModeRef=MainApp
      DummyTask (OsTask): OsTaskActivation=1, OsTaskPriority=15, OsTaskSchedule=FULL, OsTaskStackSize=AKTSP_TASK_STACK_SIZE, OsTaskResourceRef=DummyResource
      DummyResource (OsResource): OsResourceProperty=STANDARD
      DummyEvent (OsEvent)
      AKTG_C1ISR_COMMON_AKTSP_INTNO_B (OsIsr): OsIsrCategory=CATEGORY_1, OsIsrInterruptNumber=AKTSP_INTNO_B, OsIsrInterruptPriority=7
      AKTG_C2ISR_COMMON_AKTSP_INTNO_F (OsIsr): OsIsrCategory=CATEGORY_2, OsIsrInterruptNumber=AKTSP_INTNO_F, OsIsrInterruptPriority=3, OsIsrStackSize=AKTSP_C2ISR_STACK_SIZE
      4 x OsTask, all with OsTaskActivation=1, OsTaskSchedule=FULL, OsTaskStackSize=AKTSP_TASK_STACK_SIZE:
        TaskResource3: OsTaskPriority=7, OsTaskResourceRef=ResourceA, OsTaskResourceRef=ResourceB, OsTaskResourceRef=ResourceC
        TaskPri12b: OsTaskPriority=12
        TaskPri11a: OsTaskPriority=11
        TaskPri0b: OsTaskPriority=0
      ResourceB (OsResource): OsResourceProperty=STANDARD
      ResourceInternal (OsResource): OsResourceProperty=INTERNAL
      EventA (OsEvent): OsEventMask=1
      APPLICATION_MODE1 (OsAppMode)
      TaskPri9a (OsTask): OsTaskActivation=1, OsTaskPriority=9, OsTaskSchedule=FULL, OsTaskStackSize=AKTSP_TASK_STACK_SIZE
      TaskPri0c (OsTask): OsTaskActivation=1, OsTaskPriority=0, OsTaskSchedule=FULL, OsTaskStackSize=AKTSP_TASK_STACK_SIZE
      ResourceC (OsResource): OsResourceProperty=STANDARD
      EventB (OsEvent): OsEventMask=16
      4 x OsTask, all with OsTaskStackSize=AKTSP_TASK_STACK_SIZE:
        TaskPri12c: OsTaskActivation=1, OsTaskPriority=12, OsTaskSchedule=FULL
        TaskPri10a: OsTaskActivation=1, OsTaskPriority=10, OsTaskSchedule=FULL
        TaskPri9b: OsTaskActivation=1, OsTaskPriority=9, OsTaskSchedule=NON, OsTaskResourceRef=ResourceA
        TaskPri8a: OsTaskActivation=3, OsTaskPriority=8, OsTaskSchedule=FULL
          OsTaskAutostart: OsTaskAppModeRef=APPLICATION_MODE1, OsTaskAppModeRef=APPLICATION_MODE2, OsTaskAppModeRef=MainApp
      ResourceD (OsResource): OsResourceProperty=STANDARD
      EventC (OsEvent): OsEventMask=256
      APPLICATION_MODE2 (OsAppMode)
      TaskPri10b (OsTask): OsTaskActivation=1, OsTaskPriority=10, OsTaskSchedule=FULL, OsTaskStackSize=AKTSP_TASK_STACK_SIZE
      TaskPri7a (OsTask): OsTaskActivation=1, OsTaskPriority=7, OsTaskSchedule=FULL, OsTaskStackSize=AKTSP_TASK_STACK_SIZE, OsTaskResourceRef=ResourceInternal
      ResourceE (OsResource): OsResourceProperty=STANDARD
      EventD (OsEvent): OsEventMask=4096
      AlarmVerify (OsAlarm): OsAlarmCounterRef=CounterVerify
        OsAlarmAction
          OsAlarmCallback: OsAlarmCallbackName=AlarmCallBackVerify
      CounterVerify (OsCounter): OsCounterMaxAllowedValue=10, OsCounterMinCycle=1, OsCounterTicksPerBase=1, OsCounterType=SOFTWARE
      APPLICATION_MODE3 (OsAppMode)
      4 x OsTask, all with OsTaskActivation=1, OsTaskSchedule=FULL, OsTaskStackSize=AKTSP_TASK_STACK_SIZE:
        TaskEventBC: OsTaskPriority=9, OsTaskEventRef=EventB, OsTaskEventRef=EventC
        TaskEventDE: OsTaskPriority=4, OsTaskEventRef=EventD, OsTaskEventRef=EventE
        TaskPri7b: OsTaskPriority=7
        TaskPri6a: OsTaskPriority=6
      ResourceF (OsResource): OsResourceProperty=STANDARD
      EventE (OsEvent): OsEventMask=65536
      4 x OsTask, all with OsTaskActivation=1, OsTaskSchedule=FULL:
        TaskSus: OsTaskPriority=2, OsTaskStackSize=1024, OsTaskResourceRef=ResourceF, OsTaskEventRef=EventF
          OsTaskAutostart: OsTaskAppModeRef=APPLICATION_MODE3
        TaskEventA: OsTaskPriority=13, OsTaskStackSize=AKTSP_TASK_STACK_SIZE, OsTaskEventRef=EventA
        TaskPri6b: OsTaskPriority=6, OsTaskStackSize=AKTSP_TASK_STACK_SIZE, OsTaskResourceRef=ResourceE
        TaskPri5a: OsTaskPriority=5, OsTaskStackSize=AKTSP_TASK_STACK_SIZE
      EventF (OsEvent): OsEventMask=1048576
      18 x OsTask, all with OsTaskActivation=1, OsTaskStackSize=AKTSP_TASK_STACK_SIZE:
        TaskPri5b: OsTaskPriority=5, OsTaskSchedule=FULL, OsTaskResourceRef=ResourceInternal
        TaskPri4a: OsTaskPriority=4, OsTaskSchedule=FULL
        TaskPri15a: OsTaskPriority=15, OsTaskSchedule=FULL
        TaskPri4b: OsTaskPriority=4, OsTaskSchedule=FULL, OsTaskResourceRef=ResourceD
        TaskPri3a: OsTaskPriority=3, OsTaskSchedule=FULL
        TaskResource1: OsTaskPriority=1, OsTaskSchedule=FULL, OsTaskResourceRef=ResourceF
        TaskPri15b: OsTaskPriority=15, OsTaskSchedule=FULL
        TaskPri14a: OsTaskPriority=14, OsTaskSchedule=FULL, OsTaskResourceRef=ResourceC
        TaskPri2a: OsTaskPriority=2, OsTaskSchedule=FULL
        TaskResource2: OsTaskPriority=3, OsTaskSchedule=FULL, OsTaskResourceRef=ResourceD, OsTaskResourceRef=ResourceE
        TaskPri15c: OsTaskPriority=15, OsTaskSchedule=NON
        TaskPri13a: OsTaskPriority=13, OsTaskSchedule=NON, OsTaskResourceRef=ResourceB
        TaskPri2b: OsTaskPriority=2, OsTaskSchedule=FULL
        TaskPri1a: OsTaskPriority=1, OsTaskSchedule=FULL
        TaskPri13b: OsTaskPriority=13, OsTaskSchedule=FULL
        TaskPri12a: OsTaskPriority=12, OsTaskSchedule=FULL
        TaskPri1b: OsTaskPriority=1, OsTaskSchedule=FULL
        TaskPri0a: OsTaskPriority=0, OsTaskSchedule=FULL
      ResourceA (OsResource): OsResourceProperty=STANDARD
