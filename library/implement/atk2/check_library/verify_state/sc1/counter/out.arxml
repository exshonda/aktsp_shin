AUTOSAR XML (schema 4-0-2)
package /Ecuc
  module config Os
    containers atk2-header-file=out.h:
      MainApp (OsAppMode)
      OsOS: OsStackMonitoring=true, OsStatus=EXTENDED, OsUseGetServiceId=true, OsUseParameterAccess=true
        OsHooks: OsErrorHook=true, OsPostTaskHook=true, OsPreTaskHook=true, OsProtectionHook=true, OsShutdownHook=false, OsStartupHook=false
        OsHookStack: OsHookStackSize=AKTSP_HOOK_STACK_SIZE
      MainTask (OsTask):
        OsTaskActivation = 1
        OsTaskPriority = 0
        OsTaskSchedule = FULL
        OsTaskStackSize = AKTSP_TASK_STACK_SIZE
        OsTaskResourceRef = DummyResource
        OsTaskEventRef = DummyEvent
        OsTaskAutostart: OsTaskAppModeRef=MainApp
      DummyTask (OsTask): OsTaskActivation=1, OsTaskPriority=15, OsTaskSchedule=FULL, OsTaskStackSize=AKTSP_TASK_STACK_SIZE, OsTaskResourceRef=DummyResource
      DummyResource (OsResource): OsResourceProperty=STANDARD
      DummyEvent (OsEvent)
      AKTG_C2ISR_FOR_HWCNT (OsIsr): OsIsrCategory=CATEGORY_2, OsIsrInterruptNumber=AKTSP_INTNO_HWCNT, OsIsrInterruptPriority=5, OsIsrStackSize=AKTSP_C2ISR_STACK_SIZE
      DUMMY_HARDWARE_COUNTER (OsCounter):
        OsCounterMaxAllowedValue = 10
        OsCounterMinCycle = 2
        OsCounterTicksPerBase = 1
        OsCounterType = HARDWARE
        OsSecondsPerTick = 1.0
        OsCounterISRRef = AKTG_C2ISR_FOR_HWCNT
      AKTG_C1ISR_COMMON_AKTSP_INTNO_B (OsIsr): OsIsrCategory=CATEGORY_1, OsIsrInterruptNumber=AKTSP_INTNO_B, OsIsrInterruptPriority=7
      AKTG_C2ISR_COMMON_AKTSP_INTNO_F (OsIsr): OsIsrCategory=CATEGORY_2, OsIsrInterruptNumber=AKTSP_INTNO_F, OsIsrInterruptPriority=3, OsIsrStackSize=AKTSP_C2ISR_STACK_SIZE
      Counter2 (OsCounter): OsCounterMaxAllowedValue=10, OsCounterMinCycle=2, OsCounterTicksPerBase=1, OsCounterType=SOFTWARE
      Counter3 (OsCounter): OsCounterMaxAllowedValue=15, OsCounterMinCycle=3, OsCounterTicksPerBase=1, OsCounterType=SOFTWARE
      AlarmVerify (OsAlarm): OsAlarmCounterRef=CounterVerify
        OsAlarmAction
          OsAlarmCallback: OsAlarmCallbackName=AlarmCallBackVerify
      CounterVerify (OsCounter): OsCounterMaxAllowedValue=10, OsCounterMinCycle=1, OsCounterTicksPerBase=1, OsCounterType=SOFTWARE
      TaskActTask (OsTask): OsTaskActivation=1, OsTaskPriority=6, OsTaskSchedule=FULL, OsTaskStackSize=AKTSP_TASK_STACK_SIZE
      AlarmActTask (OsAlarm): OsAlarmCounterRef=Counter1
        OsAlarmAction
          OsAlarmActivateTask: OsAlarmActivateTaskRef=TaskActTask
      TaskVerify (OsTask): OsTaskActivation=1, OsTaskPriority=5, OsTaskSchedule=FULL, OsTaskStackSize=AKTSP_TASK_STACK_SIZE
      Counter1 (OsCounter): OsCounterMaxAllowedValue=8, OsCounterMinCycle=1, OsCounterTicksPerBase=1, OsCounterType=SOFTWARE
