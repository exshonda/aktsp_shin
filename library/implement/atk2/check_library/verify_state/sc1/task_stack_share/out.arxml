AUTOSAR XML (schema 4-0-2)
package /Ecuc
  module config Os
    containers atk2-header-file=out.h:
      MainApp (OsAppMode)
      OsOS: OsStackMonitoring=true, OsStatus=EXTENDED, OsUseGetServiceId=true, OsUseParameterAccess=true
        OsHooks: OsErrorHook=true, OsPostTaskHook=true, OsPreTaskHook=true, OsProtectionHook=true, OsShutdownHook=false, OsStartupHook=false
        OsHookStack: OsHookStackSize=AKTSP_HOOK_STACK_SIZE
        OsOsStack: OsOsStackSize=AKTSP_OS_STACK_SIZE, OsOsStackStartAddress=aktg_os_stack
      MainTask (OsTask):
        OsTaskActivation = 1
        OsTaskPriority = 0
        OsTaskSchedule = FULL
        OsTaskStackSize = AKTSP_TASK_STACK_SIZE
        OsTaskResourceRef = DummyResource
        OsTaskEventRef = DummyEvent
        OsTaskAutostart: OsTaskAppModeRef=MainApp
      DummyTask (OsTask): OsTaskActivation=1, OsTaskPriority=15, OsTaskSchedule=FULL, OsTaskStackSize=AKTSP_TASK_STACK_SIZE, OsTaskResourceRef=DummyResource
      DummyResource (OsResource): OsResourceProperty=STANDARD
      DummyEvent (OsEvent)
      AKTG_C1ISR_COMMON_AKTSP_INTNO_B (OsIsr): OsIsrCategory=CATEGORY_1, OsIsrInterruptNumber=AKTSP_INTNO_B, OsIsrInterruptPriority=7
      AKTG_C2ISR_COMMON_AKTSP_INTNO_F (OsIsr): OsIsrCategory=CATEGORY_2, OsIsrInterruptNumber=AKTSP_INTNO_F, OsIsrInterruptPriority=3, OsIsrStackSize=AKTSP_C2ISR_STACK_SIZE
      CounterVerify (OsCounter): OsCounterMaxAllowedValue=10, OsCounterMinCycle=1, OsCounterTicksPerBase=1, OsCounterType=SOFTWARE
      Task1 (OsTask): OsTaskActivation=1, OsTaskPriority=2, OsTaskSchedule=FULL, OsTaskStackSize=AKTSP_TASK_STACK_SIZE, OsTaskStackStartAddress=aktg_stack[0]
      TaskVerify (OsTask): OsTaskActivation=1, OsTaskPriority=5, OsTaskSchedule=FULL, OsTaskStackSize=AKTSP_TASK_STACK_SIZE, OsTaskStackStartAddress=aktg_stack[1]
      AlarmVerify (OsAlarm): OsAlarmCounterRef=CounterVerify
        OsAlarmAction
          OsAlarmCallback: OsAlarmCallbackName=AlarmCallBackVerify
