AUTOSAR XML (schema 4-0-2)
package /Ecuc
  module config Os
    containers atk2-header-file=out.h:
      MainApp (OsAppMode)
      OsOS: OsStackMonitoring=true, OsStatus=EXTENDED, OsUseGetServiceId=true, OsUseParameterAccess=true
        OsHooks: OsErrorHook=true, OsPostTaskHook=true, OsPreTaskHook=true, OsProtectionHook=true, OsShutdownHook=false, OsStartupHook=false
        OsHookStack: OsHookStackSize=AKTSP_HOOK_STACK_SIZE
      MainTask (OsTask):
        OsTaskActivation = 1
        OsTaskPriority = 0
        OsTaskSchedule = FULL
        OsTaskStackSize = AKTSP_TASK_STACK_SIZE
        OsTaskResourceRef = DummyResource
        OsTaskEventRef = DummyEvent
        OsTaskAutostart: OsTaskAppModeRef=MainApp
      DummyTask (OsTask): OsTaskActivation=1, OsTaskPriority=15, OsTaskSchedule=FULL, OsTaskStackSize=AKTSP_TASK_STACK_SIZE, OsTaskResourceRef=DummyResource
      DummyResource (OsResource): OsResourceProperty=STANDARD
      DummyEvent (OsEvent)
      AKTG_C1ISR_COMMON_AKTSP_INTNO_B (OsIsr): OsIsrCategory=CATEGORY_1, OsIsrInterruptNumber=AKTSP_INTNO_B, OsIsrInterruptPriority=7
      AKTG_C2ISR_COMMON_AKTSP_INTNO_F (OsIsr): OsIsrCategory=CATEGORY_2, OsIsrInterruptNumber=AKTSP_INTNO_F, OsIsrInterruptPriority=3, OsIsrStackSize=AKTSP_C2ISR_STACK_SIZE
      AlarmSetEvent (OsAlarm): OsAlarmCounterRef=Counter
        OsAlarmAction
          OsAlarmSetEvent: OsAlarmSetEventTaskRef=TaskSetEvent, OsAlarmSetEventRef=Event1
        OsAlarmAutostart:
          OsAlarmAlarmTime = 1
          OsAlarmCycleTime = 8
          OsAlarmAutostartType = RELATIVE
          OsAlarmAppModeRef = APPLICATION_MODE2
          OsAlarmAppModeRef = APPLICATION_MODE3
          OsAlarmAppModeRef = MainApp
      APPLICATION_MODE1 (OsAppMode)
      CounterInc (OsCounter): OsCounterMaxAllowedValue=10, OsCounterMinCycle=2, OsCounterTicksPerBase=1, OsCounterType=SOFTWARE
      APPLICATION_MODE2 (OsAppMode)
      AlarmVerify (OsAlarm): OsAlarmCounterRef=CounterVerify
        OsAlarmAction
          OsAlarmCallback: OsAlarmCallbackName=AlarmCallBackVerify
      CounterVerify (OsCounter): OsCounterMaxAllowedValue=10, OsCounterMinCycle=1, OsCounterTicksPerBase=1, OsCounterType=SOFTWARE
      APPLICATION_MODE3 (OsAppMode)
      3 x OsAlarm, all with OsAlarmCounterRef=Counter:
        AlarmUnset
          OsAlarmAction
            OsAlarmActivateTask: OsAlarmActivateTaskRef=TaskUnset
        AlarmAlmCallBack
          OsAlarmAction
            OsAlarmCallback: OsAlarmCallbackName=AlarmCallBack
        AlarmIncCounter
          OsAlarmAction
            OsAlarmIncrementCounter: OsAlarmIncrementCounterRef=CounterInc
      Event1 (OsEvent)
      TaskUnset (OsTask): OsTaskActivation=1, OsTaskPriority=2, OsTaskSchedule=FULL, OsTaskStackSize=AKTSP_TASK_STACK_SIZE
      TaskActTask (OsTask): OsTaskActivation=1, OsTaskPriority=6, OsTaskSchedule=FULL, OsTaskStackSize=AKTSP_TASK_STACK_SIZE
      AlarmActTask (OsAlarm): OsAlarmCounterRef=Counter
        OsAlarmAction
          OsAlarmActivateTask: OsAlarmActivateTaskRef=TaskActTask
        OsAlarmAutostart: OsAlarmAlarmTime=2, OsAlarmCycleTime=5, OsAlarmAutostartType=ABSOLUTE, OsAlarmAppModeRef=APPLICATION_MODE1, OsAlarmAppModeRef=MainApp
      TaskVerify (OsTask): OsTaskActivation=1, OsTaskPriority=5, OsTaskSchedule=FULL, OsTaskStackSize=AKTSP_TASK_STACK_SIZE
      TaskSetEvent (OsTask): OsTaskActivation=1, OsTaskPriority=2, OsTaskSchedule=FULL, OsTaskStackSize=AKTSP_TASK_STACK_SIZE, OsTaskEventRef=Event1
      Counter (OsCounter): OsCounterMaxAllowedValue=8, OsCounterMinCycle=1, OsCounterTicksPerBase=1, OsCounterType=SOFTWARE
