AUTOSAR XML (schema 4-0-2)
package /Ecuc
  module config Os
    containers atk2-header-file=out.h:
      MainApp (OsAppMode)
      OsOS: OsStackMonitoring=true, OsStatus=EXTENDED, OsUseGetServiceId=true, OsUseParameterAccess=true
        OsHooks: OsErrorHook=true, OsPostTaskHook=true, OsPreTaskHook=true, OsProtectionHook=true, OsShutdownHook=false, OsStartupHook=false
        OsHookStack: OsHookStackSize=AKTSP_HOOK_STACK_SIZE
      MainTask (OsTask):
        OsTaskActivation = 1
        OsTaskPriority = 0
        OsTaskSchedule = FULL
        OsTaskStackSize = AKTSP_TASK_STACK_SIZE
        OsTaskResourceRef = DummyResource
        OsTaskEventRef = DummyEvent
        OsTaskAutostart: OsTaskAppModeRef=MainApp
      DummyTask (OsTask): OsTaskActivation=1, OsTaskPriority=15, OsTaskSchedule=FULL, OsTaskStackSize=AKTSP_TASK_STACK_SIZE, OsTaskResourceRef=DummyResource
      DummyResource (OsResource): OsResourceProperty=STANDARD
      DummyEvent (OsEvent)
      AKTG_C2ISR_FOR_HWCNT (OsIsr): OsIsrCategory=CATEGORY_2, OsIsrInterruptNumber=AKTSP_INTNO_HWCNT, OsIsrInterruptPriority=5, OsIsrStackSize=AKTSP_C2ISR_STACK_SIZE
      DUMMY_HARDWARE_COUNTER (OsCounter):
        OsCounterMaxAllowedValue = 10
        OsCounterMinCycle = 2
        OsCounterTicksPerBase = 1
        OsCounterType = HARDWARE
        OsSecondsPerTick = 1.0
        OsCounterISRRef = AKTG_C2ISR_FOR_HWCNT
      AKTG_C1ISR_COMMON_AKTSP_INTNO_B (OsIsr): OsIsrCategory=CATEGORY_1, OsIsrInterruptNumber=AKTSP_INTNO_B, OsIsrInterruptPriority=7
      AKTG_C2ISR_COMMON_AKTSP_INTNO_F (OsIsr): OsIsrCategory=CATEGORY_2, OsIsrInterruptNumber=AKTSP_INTNO_F, OsIsrInterruptPriority=3, OsIsrStackSize=AKTSP_C2ISR_STACK_SIZE
      Task1_2 (OsTask): OsTaskActivation=1, OsTaskPriority=14, OsTaskSchedule=FULL, OsTaskStackSize=AKTSP_TASK_STACK_SIZE
      Task2_1 (OsTask): OsTaskActivation=1, OsTaskPriority=10, OsTaskSchedule=FULL, OsTaskStackSize=AKTSP_TASK_STACK_SIZE, OsTaskEventRef=Event2_1
      Counter2 (OsCounter): OsCounterMaxAllowedValue=10, OsCounterMinCycle=1, OsCounterTicksPerBase=1, OsCounterType=SOFTWARE
      APPLICATION_MODE1 (OsAppMode)
      3 x OsTask, all with OsTaskActivation=1, OsTaskSchedule=FULL, OsTaskStackSize=AKTSP_TASK_STACK_SIZE:
        Task1_3: OsTaskPriority=13
        Task2_2: OsTaskPriority=10, OsTaskEventRef=Event2_2
        Task3_1: OsTaskPriority=8, OsTaskEventRef=Event3_1
      APPLICATION_MODE2 (OsAppMode)
      4 x OsTask, all with OsTaskActivation=1, OsTaskSchedule=FULL, OsTaskStackSize=AKTSP_TASK_STACK_SIZE:
        Task1_4: OsTaskPriority=12
        Task2_3: OsTaskPriority=10, OsTaskEventRef=Event2_3
        Task3_2: OsTaskPriority=7, OsTaskEventRef=Event3_2
        Task4_1: OsTaskPriority=3
      Event2_1 (OsEvent)
      AlarmVerify (OsAlarm): OsAlarmCounterRef=CounterVerify
        OsAlarmAction
          OsAlarmCallback: OsAlarmCallbackName=AlarmCallBackVerify
      CounterVerify (OsCounter): OsCounterMaxAllowedValue=10, OsCounterMinCycle=1, OsCounterTicksPerBase=1, OsCounterType=SOFTWARE
      APPLICATION_MODE3 (OsAppMode)
      3 x OsTask, all with OsTaskActivation=1, OsTaskSchedule=FULL, OsTaskStackSize=AKTSP_TASK_STACK_SIZE:
        Task1_5: OsTaskPriority=11
        Task2_4: OsTaskPriority=10, OsTaskEventRef=Event2_4
        Task3_3: OsTaskPriority=6, OsTaskEventRef=Event3_3
      ScheduleTable1 (OsScheduleTable): OsScheduleTableDuration=10, OsScheduleTableRepeating=true, OsScheduleTableCounterRef=Counter1
        3 x OsScheduleTableExpiryPoint:
          OsScheduleTableExpiryPoint_0: OsScheduleTblExpPointOffset=2
            OsScheduleTableTaskActivation_0 (OsScheduleTableTaskActivation): OsScheduleTableActivateTaskRef=Task1_1
          OsScheduleTableExpiryPoint_1: OsScheduleTblExpPointOffset=4
            OsScheduleTableTaskActivation_0 (OsScheduleTableTaskActivation): OsScheduleTableActivateTaskRef=Task1_2
            OsScheduleTableTaskActivation_1 (OsScheduleTableTaskActivation): OsScheduleTableActivateTaskRef=Task1_3
          OsScheduleTableExpiryPoint_2: OsScheduleTblExpPointOffset=6
            3 x OsScheduleTableTaskActivation:
              OsScheduleTableTaskActivation_0: OsScheduleTableActivateTaskRef=Task1_4
              OsScheduleTableTaskActivation_1: OsScheduleTableActivateTaskRef=Task1_5
              OsScheduleTableTaskActivation_2: OsScheduleTableActivateTaskRef=Task1_6
        OsScheduleTableSync: OsScheduleTblSyncStrategy=NONE
        OsScheduleTableAutostart: OsScheduleTableStartValue=2, OsScheduleTableAutostartType=RELATIVE, OsScheduleTableAppModeRef=APPLICATION_MODE1, OsScheduleTableAppModeRef=MainApp
      Event2_2 (OsEvent)
      Event3_1 (OsEvent)
      3 x OsTask, all with OsTaskActivation=1, OsTaskSchedule=FULL, OsTaskStackSize=AKTSP_TASK_STACK_SIZE:
        Task1_6: OsTaskPriority=10
        Task2_5: OsTaskPriority=10, OsTaskEventRef=Event2_5
        Task3_4: OsTaskPriority=5, OsTaskEventRef=Event3_4
      ScheduleTable2 (OsScheduleTable): OsScheduleTableDuration=20, OsScheduleTableRepeating=false, OsScheduleTableCounterRef=Counter1
        3 x OsScheduleTableExpiryPoint:
          OsScheduleTableExpiryPoint_0: OsScheduleTblExpPointOffset=3
            OsScheduleTableEventSetting_0 (OsScheduleTableEventSetting): OsScheduleTableSetEventRef=Event2_1, OsScheduleTableSetEventTaskRef=Task2_1
          OsScheduleTableExpiryPoint_1: OsScheduleTblExpPointOffset=8
            OsScheduleTableEventSetting_0 (OsScheduleTableEventSetting): OsScheduleTableSetEventRef=Event2_2, OsScheduleTableSetEventTaskRef=Task2_2
            OsScheduleTableEventSetting_1 (OsScheduleTableEventSetting): OsScheduleTableSetEventRef=Event2_3, OsScheduleTableSetEventTaskRef=Task2_3
          OsScheduleTableExpiryPoint_2: OsScheduleTblExpPointOffset=13
            3 x OsScheduleTableEventSetting:
              OsScheduleTableEventSetting_0: OsScheduleTableSetEventRef=Event2_4, OsScheduleTableSetEventTaskRef=Task2_4
              OsScheduleTableEventSetting_1: OsScheduleTableSetEventRef=Event2_5, OsScheduleTableSetEventTaskRef=Task2_5
              OsScheduleTableEventSetting_2: OsScheduleTableSetEventRef=Event2_6, OsScheduleTableSetEventTaskRef=Task2_6
        OsScheduleTableSync: OsScheduleTblSyncStrategy=NONE
      Event2_3 (OsEvent)
      Event3_2 (OsEvent)
      Task2_6 (OsTask): OsTaskActivation=1, OsTaskPriority=10, OsTaskSchedule=FULL, OsTaskStackSize=AKTSP_TASK_STACK_SIZE, OsTaskEventRef=Event2_6
      Task3_5 (OsTask): OsTaskActivation=1, OsTaskPriority=4, OsTaskSchedule=FULL, OsTaskStackSize=AKTSP_TASK_STACK_SIZE, OsTaskEventRef=Event3_5
      ScheduleTable3 (OsScheduleTable): OsScheduleTableDuration=11, OsScheduleTableRepeating=true, OsScheduleTableCounterRef=DUMMY_HARDWARE_COUNTER
        3 x OsScheduleTableExpiryPoint:
          OsScheduleTableExpiryPoint_0: OsScheduleTblExpPointOffset=3
            OsScheduleTableTaskActivation_0 (OsScheduleTableTaskActivation): OsScheduleTableActivateTaskRef=Task3_1
            OsScheduleTableEventSetting_0 (OsScheduleTableEventSetting): OsScheduleTableSetEventRef=Event3_1, OsScheduleTableSetEventTaskRef=Task3_1
          OsScheduleTableExpiryPoint_1: OsScheduleTblExpPointOffset=7
            OsScheduleTableTaskActivation_0 (OsScheduleTableTaskActivation): OsScheduleTableActivateTaskRef=Task3_2
            OsScheduleTableTaskActivation_1 (OsScheduleTableTaskActivation): OsScheduleTableActivateTaskRef=Task3_3
            OsScheduleTableEventSetting_0 (OsScheduleTableEventSetting): OsScheduleTableSetEventRef=Event3_2, OsScheduleTableSetEventTaskRef=Task3_2
            OsScheduleTableEventSetting_1 (OsScheduleTableEventSetting): OsScheduleTableSetEventRef=Event3_3, OsScheduleTableSetEventTaskRef=Task3_3
          OsScheduleTableExpiryPoint_2: OsScheduleTblExpPointOffset=9
            3 x OsScheduleTableTaskActivation:
              OsScheduleTableTaskActivation_0: OsScheduleTableActivateTaskRef=Task3_4
              OsScheduleTableTaskActivation_1: OsScheduleTableActivateTaskRef=Task3_5
              OsScheduleTableTaskActivation_2: OsScheduleTableActivateTaskRef=Task3_6
            3 x OsScheduleTableEventSetting:
              OsScheduleTableEventSetting_0: OsScheduleTableSetEventRef=Event3_4, OsScheduleTableSetEventTaskRef=Task3_4
              OsScheduleTableEventSetting_1: OsScheduleTableSetEventRef=Event3_5, OsScheduleTableSetEventTaskRef=Task3_5
              OsScheduleTableEventSetting_2: OsScheduleTableSetEventRef=Event3_6, OsScheduleTableSetEventTaskRef=Task3_6
        OsScheduleTableSync: OsScheduleTblSyncStrategy=IMPLICIT
      Event2_4 (OsEvent)
      Event3_3 (OsEvent)
      Task3_6 (OsTask): OsTaskActivation=1, OsTaskPriority=3, OsTaskSchedule=FULL, OsTaskStackSize=AKTSP_TASK_STACK_SIZE, OsTaskEventRef=Event3_6
      ScheduleTable4 (OsScheduleTable): OsScheduleTableDuration=11, OsScheduleTableRepeating=false, OsScheduleTableCounterRef=Counter2
        OsScheduleTableExpiryPoint_0 (OsScheduleTableExpiryPoint): OsScheduleTblExpPointOffset=2
          OsScheduleTableTaskActivation_0 (OsScheduleTableTaskActivation): OsScheduleTableActivateTaskRef=Task4_1
        OsScheduleTableSync: OsScheduleTblSyncStrategy=IMPLICIT
        OsScheduleTableAutostart:
          OsScheduleTableStartValue = 3
          OsScheduleTableAutostartType = ABSOLUTE
          OsScheduleTableAppModeRef = APPLICATION_MODE2
          OsScheduleTableAppModeRef = APPLICATION_MODE3
          OsScheduleTableAppModeRef = MainApp
      4 x OsEvent:
        Event2_5
        Event3_4
        Event2_6
        Event3_5
      TaskVerify (OsTask): OsTaskActivation=1, OsTaskPriority=9, OsTaskSchedule=FULL, OsTaskStackSize=AKTSP_TASK_STACK_SIZE
      Event3_6 (OsEvent)
      Task1_1 (OsTask): OsTaskActivation=1, OsTaskPriority=15, OsTaskSchedule=FULL, OsTaskStackSize=AKTSP_TASK_STACK_SIZE
      Counter1 (OsCounter): OsCounterMaxAllowedValue=19, OsCounterMinCycle=1, OsCounterTicksPerBase=1, OsCounterType=SOFTWARE
