AUTOSAR XML (schema 4-0-2)
package /Ecuc
  module config Os
    containers atk2-header-file=out.h:
      MainApp (OsAppMode)
      OsOS: OsStackMonitoring=true, OsStatus=EXTENDED, OsUseGetServiceId=true, OsUseParameterAccess=true
        OsHooks: OsErrorHook=true, OsPostTaskHook=true, OsPreTaskHook=true, OsProtectionHook=true, OsShutdownHook=false, OsStartupHook=false
        OsHookStack: OsHookStackSize=AKTSP_HOOK_STACK_SIZE
      MainTask (OsTask):
        OsTaskActivation = 1
        OsTaskPriority = 0
        OsTaskSchedule = FULL
        OsTaskStackSize = AKTSP_TASK_STACK_SIZE
        OsTaskResourceRef = DummyResource
        OsTaskEventRef = DummyEvent
        OsTaskAutostart: OsTaskAppModeRef=MainApp
      DummyTask (OsTask): OsTaskActivation=1, OsTaskPriority=15, OsTaskSchedule=FULL, OsTaskStackSize=AKTSP_TASK_STACK_SIZE, OsTaskResourceRef=DummyResource
      DummyResource (OsResource): OsResourceProperty=STANDARD
      DummyEvent (OsEvent)
      AKTG_C1ISR_COMMON_AKTSP_INTNO_B (OsIsr): OsIsrCategory=CATEGORY_1, OsIsrInterruptNumber=AKTSP_INTNO_B, OsIsrInterruptPriority=7
      AKTG_C2ISR_COMMON_AKTSP_INTNO_F (OsIsr): OsIsrCategory=CATEGORY_2, OsIsrInterruptNumber=AKTSP_INTNO_F, OsIsrInterruptPriority=3, OsIsrStackSize=AKTSP_C2ISR_STACK_SIZE
      3 x OsTask, all with OsTaskActivation=1, OsTaskPriority=1, OsTaskSchedule=FULL, OsTaskStackSize=AKTSP_TASK_STACK_SIZE:
        TaskDummy5: OsTaskResourceRef=StandardResUnl
        TaskDummy6: OsTaskResourceRef=InternalResUnl
        TaskDummy7: OsTaskResourceRef=InternalResUnl
      StandardResLock (OsResource): OsResourceProperty=STANDARD
      LinkedResUnl (OsResource): OsResourceProperty=LINKED, OsResourceLinkedResourceRef=StandardResUnl
      AlarmVerify (OsAlarm): OsAlarmCounterRef=CounterVerify
        OsAlarmAction
          OsAlarmCallback: OsAlarmCallbackName=AlarmCallBackVerify
      CounterVerify (OsCounter): OsCounterMaxAllowedValue=10, OsCounterMinCycle=1, OsCounterTicksPerBase=1, OsCounterType=SOFTWARE
      TaskLinkedRes (OsTask): OsTaskActivation=1, OsTaskPriority=6, OsTaskSchedule=FULL, OsTaskStackSize=AKTSP_TASK_STACK_SIZE, OsTaskResourceRef=StandardResforLnk
      InternalResLock (OsResource): OsResourceProperty=INTERNAL
      TaskDummy1 (OsTask): OsTaskActivation=1, OsTaskPriority=3, OsTaskSchedule=FULL, OsTaskStackSize=AKTSP_TASK_STACK_SIZE, OsTaskResourceRef=StandardResLock
      4 x OsResource:
        InternalResUnl: OsResourceProperty=INTERNAL
        StandardResUnl: OsResourceProperty=STANDARD
        StandardResforLnk: OsResourceProperty=STANDARD
        LinkedResLock: OsResourceProperty=LINKED, OsResourceLinkedResourceRef=StandardResforLnk
      5 x OsTask, all with OsTaskActivation=1, OsTaskSchedule=FULL, OsTaskStackSize=AKTSP_TASK_STACK_SIZE:
        TaskInternalRes: OsTaskPriority=9, OsTaskResourceRef=InternalResLock
        TaskDummy2: OsTaskPriority=5, OsTaskResourceRef=InternalResLock
        TaskDummy3: OsTaskPriority=7, OsTaskResourceRef=StandardResforLnk
        TaskStandardRes: OsTaskPriority=2, OsTaskResourceRef=StandardResLock
        TaskDummy4: OsTaskPriority=1, OsTaskResourceRef=StandardResUnl
