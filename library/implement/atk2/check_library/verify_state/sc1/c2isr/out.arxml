AUTOSAR XML (schema 4-0-2)
package /Ecuc
  module config Os
    containers atk2-header-file=out.h:
      MainApp (OsAppMode)
      OsOS: OsStackMonitoring=true, OsStatus=EXTENDED, OsUseGetServiceId=true, OsUseParameterAccess=true
        OsHooks: OsErrorHook=true, OsPostTaskHook=true, OsPreTaskHook=true, OsProtectionHook=true, OsShutdownHook=false, OsStartupHook=false
        OsHookStack: OsHookStackSize=AKTSP_HOOK_STACK_SIZE
      MainTask (OsTask):
        OsTaskActivation = 1
        OsTaskPriority = 0
        OsTaskSchedule = FULL
        OsTaskStackSize = AKTSP_TASK_STACK_SIZE
        OsTaskResourceRef = DummyResource
        OsTaskEventRef = DummyEvent
        OsTaskAutostart: OsTaskAppModeRef=MainApp
      DummyTask (OsTask): OsTaskActivation=1, OsTaskPriority=15, OsTaskSchedule=FULL, OsTaskStackSize=AKTSP_TASK_STACK_SIZE, OsTaskResourceRef=DummyResource
      DummyResource (OsResource): OsResourceProperty=STANDARD
      DummyEvent (OsEvent)
      4 x OsIsr:
        AKTG_C1ISR_COMMON_AKTSP_INTNO_B: OsIsrCategory=CATEGORY_1, OsIsrInterruptNumber=AKTSP_INTNO_B, OsIsrInterruptPriority=7
        AKTG_C2ISR_COMMON_AKTSP_INTNO_E: OsIsrCategory=CATEGORY_2, OsIsrInterruptNumber=AKTSP_INTNO_E, OsIsrInterruptPriority=4, OsIsrStackSize=AKTSP_C2ISR_STACK_SIZE, OsIsrResourceRef=ResourceA, OsIsrResourceRef=ResourceB
        AKTG_C2ISR_COMMON_AKTSP_INTNO_F: OsIsrCategory=CATEGORY_2, OsIsrInterruptNumber=AKTSP_INTNO_F, OsIsrInterruptPriority=3, OsIsrStackSize=AKTSP_C2ISR_STACK_SIZE, OsIsrResourceRef=ResourceC
        AKTG_C2ISR_COMMON_AKTSP_INTNO_I: OsIsrCategory=CATEGORY_2, OsIsrInterruptNumber=AKTSP_INTNO_I, OsIsrInterruptPriority=2, OsIsrStackSize=256, OsIsrResourceRef=ResourceA
      ResourceB (OsResource): OsResourceProperty=STANDARD
      ResourceC (OsResource): OsResourceProperty=STANDARD
      AlarmVerify (OsAlarm): OsAlarmCounterRef=CounterVerify
        OsAlarmAction
          OsAlarmCallback: OsAlarmCallbackName=AlarmCallBackVerify
      CounterVerify (OsCounter): OsCounterMaxAllowedValue=10, OsCounterMinCycle=1, OsCounterTicksPerBase=1, OsCounterType=SOFTWARE
      TaskDummy1 (OsTask): OsTaskActivation=1, OsTaskPriority=1, OsTaskSchedule=FULL, OsTaskStackSize=AKTSP_TASK_STACK_SIZE, OsTaskResourceRef=ResourceB
      TaskVerify (OsTask): OsTaskActivation=1, OsTaskPriority=5, OsTaskSchedule=FULL, OsTaskStackSize=AKTSP_TASK_STACK_SIZE, OsTaskResourceRef=ResourceC
      ResourceA (OsResource): OsResourceProperty=STANDARD
