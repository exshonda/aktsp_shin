AUTOSAR XML (schema 4-0-3)
package /Os
  module config Os: ecuc-def-edition=4.2.0, implementation-config-variant=VARIANT-PRE-COMPILE
    OsInclude: OsIncludeFileName=out.h
    MainApp (OsAppMode)
    OsOS:
      OsStackMonitoring = true
      OsUseGetServiceId = true
      OsUseParameterAccess = true
      OsStatus = EXTENDED
      OsScalabilityClass = SC3
      OsMemoryProtectionLevel = Level2
      OsViolationHandlingLevel = Level2
      OsHooks: OsErrorHook=true, OsPostTaskHook=true, OsPreTaskHook=true, OsProtectionHook=true, OsShutdownHook=true, OsStartupHook=true
      OsHookStack: OsHookStackSize=AKTSP_HOOK_STACK_SIZE
      OsOsStack: OsOsStackSize=AKTSP_OS_STACK_SIZE
      OsNonTrustedHookStack: OsNonTrustedHookStackSize=AKTSP_NTHOOK_STACK_SIZE
    OsLinkSection: OsLinkSectionName=.stack_section, OsLinkSectionMemoryRegionRef=RAM
    3 x OsTask, all with OsTaskActivation=1, OsTaskStackSize=AKTSP_TASK_STACK_SIZE, OsTaskSchedule=FULL:
      MainTask: OsTaskPriority=0, OsTaskResourceRef=DummyResource, OsTaskEventRef=DummyEvent
        OsTaskAutostart: OsTaskAppModeRef=MainApp
      DummyTask: OsTaskPriority=15, OsTaskResourceRef=DummyResource
      NonTrustedTask: OsTaskPriority=6, OsTaskSystemStackSize=AKTSP_TASK_STACK_SIZE
    4 x OsIsr, all with OsIsrInterruptSource=ENABLE:
      AKTG_C1ISR_COMMON_AKTSP_INTNO_A: OsIsrInterruptNumber=AKTSP_INTNO_A, OsIsrInterruptPriority=AKTSP_INT_PRI_ISR1, OsIsrCategory=CATEGORY_1
      AKTG_C2ISR_COMMON_AKTSP_INTNO_B: OsIsrInterruptNumber=AKTSP_INTNO_B, OsIsrInterruptPriority=AKTSP_INT_PRI_HIGH, OsIsrStackSize=AKTSP_C2ISR_STACK_SIZE, OsIsrCategory=CATEGORY_2
      AKTG_C2ISR_COMMON_AKTSP_INTNO_C: OsIsrInterruptNumber=AKTSP_INTNO_C, OsIsrInterruptPriority=AKTSP_INT_PRI_MID, OsIsrStackSize=AKTSP_C2ISR_STACK_SIZE, OsIsrCategory=CATEGORY_2
      AKTG_C2ISR_COMMON_AKTSP_INTNO_D: OsIsrInterruptNumber=AKTSP_INTNO_D, OsIsrInterruptPriority=AKTSP_INT_PRI_LOW, OsIsrStackSize=AKTSP_C2ISR_STACK_SIZE, OsIsrCategory=CATEGORY_2
    TrustedTask (OsTask): OsTaskActivation=1, OsTaskPriority=5, OsTaskStackSize=AKTSP_TASK_STACK_SIZE, OsTaskSchedule=FULL
    DummyResource (OsResource): OsResourceProperty=STANDARD
    DummyEvent (OsEvent)
    4 x OsApplication:
      TRUSTED_MAIN_OSAP: OsTrusted=true, OsAppTaskRef=MainTask, OsAppTaskRef=DummyTask
        OsApplicationHooks: OsAppErrorHook=false, OsAppShutdownHook=false, OsAppStartupHook=false
        3 x OsApplicationTrustedFunction, all with OsTrustedFunctionStackSize=AKTSP_STACK_SIZE_FOR_TFN:
          AktspTfnActivateTask: OsTrustedFunctionName=TRUSTED_AktspTfnActivateTask
          AktspTfnSetEvent: OsTrustedFunctionName=TRUSTED_AktspTfnSetEvent
          AktspTfnShutdownOS: OsTrustedFunctionName=TRUSTED_AktspTfnShutdownOS
      NON_TRUSTED_OSAP5: OsTrusted=false, OsAppTaskRef=NonTrustedTask
        OsApplicationHooks: OsAppErrorHook=true, OsAppShutdownHook=true, OsAppStartupHook=true
      TRUSTED_OSAP1: OsTrusted=true, OsAppIsrRef=AKTG_C1ISR_COMMON_AKTSP_INTNO_A, OsAppIsrRef=AKTG_C2ISR_COMMON_AKTSP_INTNO_B, OsAppIsrRef=AKTG_C2ISR_COMMON_AKTSP_INTNO_C, OsAppIsrRef=AKTG_C2ISR_COMMON_AKTSP_INTNO_D
        OsApplicationHooks: OsAppErrorHook=false, OsAppShutdownHook=false, OsAppStartupHook=false
      TRUSTED_OSAP5: OsTrusted=true, OsAppTaskRef=TrustedTask
        OsApplicationHooks: OsAppErrorHook=true, OsAppShutdownHook=true, OsAppStartupHook=true
        VerifyTrustedFunction (OsApplicationTrustedFunction): OsTrustedFunctionStackSize=AKTSP_STACK_SIZE_FOR_TFN, OsTrustedFunctionName=TRUSTED_VerifyTrustedFunction
