AUTOSAR XML (schema 4-0-3)
package /Os
  module config Os: ecuc-def-edition=4.2.0, implementation-config-variant=VARIANT-PRE-COMPILE
    OsInclude: OsIncludeFileName=out.h
    MainApp (OsAppMode)
    OsOS:
      OsNumberOfCores = 2
      OsStackMonitoring = true
      OsUseGetServiceId = true
      OsUseParameterAccess = true
      OsStatus = EXTENDED
      OsScalabilityClass = SC3
      OsMemoryProtectionLevel = Level2
      OsViolationHandlingLevel = Level2
      OsHooks: OsErrorHook=true, OsPostTaskHook=true, OsPreTaskHook=true, OsProtectionHook=true, OsShutdownHook=true, OsStartupHook=true
      OsHookStack_0 (OsHookStack): OsHookStackSize=AKTSP_HOOK_STACK_SIZE, OsHookStackCoreAssignment=OS_CORE_ID_0
      OsHookStack_1 (OsHookStack): OsHookStackSize=AKTSP_HOOK_STACK_SIZE, OsHookStackCoreAssignment=OS_CORE_ID_1
      OsOsStack_0 (OsOsStack): OsOsStackSize=AKTSP_OS_STACK_SIZE, OsOsStackCoreAssignment=OS_CORE_ID_0
      OsOsStack_1 (OsOsStack): OsOsStackSize=AKTSP_OS_STACK_SIZE, OsOsStackCoreAssignment=OS_CORE_ID_1
      OsNonTrustedHookStack_0 (OsNonTrustedHookStack): OsNonTrustedHookStackSize=AKTSP_NTHOOK_STACK_SIZE, OsNonTrustedHookStackCoreAssignment=0
      OsNonTrustedHookStack_1 (OsNonTrustedHookStack): OsNonTrustedHookStackSize=AKTSP_NTHOOK_STACK_SIZE, OsNonTrustedHookStackCoreAssignment=1
    OsLinkSection: OsLinkSectionName=.stack_section, OsLinkSectionMemoryRegionRef=RAM
    5 x OsTask, all with OsTaskActivation=1, OsTaskStackSize=AKTSP_TASK_STACK_SIZE, OsTaskSchedule=FULL:
      MainTask: OsTaskPriority=0, OsTaskResourceRef=DummyResource, OsTaskEventRef=DummyEvent
        OsTaskAutostart: OsTaskAppModeRef=MainApp
      DummyTask: OsTaskPriority=15, OsTaskResourceRef=DummyResource
      RunTask1: OsTaskPriority=2, OsTaskSystemStackSize=AKTSP_TASK_STACK_SIZE
      MainTask1: OsTaskPriority=1, OsTaskSystemStackSize=AKTSP_TASK_STACK_SIZE
        OsTaskAutostart: OsTaskAppModeRef=MainApp
      RunTask0: OsTaskPriority=2, OsTaskSystemStackSize=AKTSP_TASK_STACK_SIZE
    DummyResource (OsResource): OsResourceProperty=STANDARD
    DummyEvent (OsEvent)
    4 x OsApplication:
      TRUSTED_MAIN_OSAP: OsApplicationCoreAssignment=OS_CORE_ID_0, OsTrusted=true, OsAppTaskRef=MainTask, OsAppTaskRef=DummyTask
        OsApplicationHooks: OsAppErrorHook=false, OsAppShutdownHook=false, OsAppStartupHook=false
        4 x OsApplicationTrustedFunction, all with OsTrustedFunctionStackSize=AKTSP_STACK_SIZE_FOR_TFN:
          AktspTfnActivateTask: OsTrustedFunctionName=TRUSTED_AktspTfnActivateTask
          AktspTfnSetEvent: OsTrustedFunctionName=TRUSTED_AktspTfnSetEvent
          AktspTfnShutdownOS: OsTrustedFunctionName=TRUSTED_AktspTfnShutdownOS
          AktspTfnRaiseInterCoreInterrupt: OsTrustedFunctionName=TRUSTED_AktspTfnRaiseInterCoreInterrupt
      TRUSTED_SUB_OSAP_1: OsApplicationCoreAssignment=OS_CORE_ID_1, OsTrusted=true
        OsApplicationHooks: OsAppErrorHook=false, OsAppShutdownHook=false, OsAppStartupHook=false
        4 x OsApplicationTrustedFunction, all with OsTrustedFunctionStackSize=AKTSP_STACK_SIZE_FOR_TFN:
          AktspTfnActivateTask_1: OsTrustedFunctionName=TRUSTED_AktspTfnActivateTask
          AktspTfnSetEvent_1: OsTrustedFunctionName=TRUSTED_AktspTfnSetEvent
          AktspTfnShutdownOS_1: OsTrustedFunctionName=TRUSTED_AktspTfnShutdownOS
          AktspTfnRaiseInterCoreInterrupt_1: OsTrustedFunctionName=TRUSTED_AktspTfnRaiseInterCoreInterrupt
      NT_OSAP_OTHER_OTHER_CORE: OsApplicationCoreAssignment=OS_CORE_ID_1, OsTrusted=false, OsAppTaskRef=RunTask1, OsAppTaskRef=MainTask1
        OsApplicationHooks: OsAppErrorHook=true, OsAppShutdownHook=true, OsAppStartupHook=true
      NT_OSAP_SELF_CORE: OsApplicationCoreAssignment=OS_CORE_ID_0, OsTrusted=false, OsAppTaskRef=RunTask0
        OsApplicationHooks: OsAppErrorHook=true, OsAppShutdownHook=true, OsAppStartupHook=true
