AUTOSAR XML (schema 4-0-3)
package /Os
  module config Os: ecuc-def-edition=4.2.0, implementation-config-variant=VARIANT-PRE-COMPILE
    OsInclude: OsIncludeFileName=out.h
    MainApp (OsAppMode)
    OsOS: OsNumberOfCores=2, OsStackMonitoring=true, OsUseGetServiceId=true, OsUseParameterAccess=true, OsStatus=EXTENDED, OsScalabilityClass=SC1
      OsHooks: OsErrorHook=true, OsPostTaskHook=true, OsPreTaskHook=true, OsProtectionHook=true, OsShutdownHook=true, OsStartupHook=true
      OsHookStack_0 (OsHookStack): OsHookStackSize=AKTSP_HOOK_STACK_SIZE, OsHookStackCoreAssignment=OS_CORE_ID_0
      OsHookStack_1 (OsHookStack): OsHookStackSize=AKTSP_HOOK_STACK_SIZE, OsHookStackCoreAssignment=OS_CORE_ID_1
      OsOsStack_0 (OsOsStack): OsOsStackSize=AKTSP_OS_STACK_SIZE, OsOsStackCoreAssignment=OS_CORE_ID_0
      OsOsStack_1 (OsOsStack): OsOsStackSize=AKTSP_OS_STACK_SIZE, OsOsStackCoreAssignment=OS_CORE_ID_1
    3 x OsTask, all with OsTaskActivation=1, OsTaskStackSize=AKTSP_TASK_STACK_SIZE, OsTaskSchedule=FULL:
      MainTask: OsTaskPriority=0, OsTaskResourceRef=DummyResource, OsTaskEventRef=DummyEvent
        OsTaskAutostart: OsTaskAppModeRef=MainApp
      DummyTask: OsTaskPriority=15, OsTaskResourceRef=DummyResource
      RunTask1: OsTaskPriority=2
    AlarmVerify1 (OsAlarm): OsAlarmCounterRef=CounterVerify1
      OsAlarmAction
        OsAlarmCallback: OsAlarmCallbackName=AlarmCallBackVerify1
    MainTask1 (OsTask): OsTaskActivation=1, OsTaskPriority=1, OsTaskStackSize=AKTSP_TASK_STACK_SIZE, OsTaskSchedule=FULL
      OsTaskAutostart: OsTaskAppModeRef=MainApp
    CounterVerify1 (OsCounter): OsCounterMaxAllowedValue=10, OsCounterMinCycle=1, OsCounterTicksPerBase=1, OsCounterType=SOFTWARE
    RunTask0 (OsTask): OsTaskActivation=1, OsTaskPriority=2, OsTaskStackSize=AKTSP_TASK_STACK_SIZE, OsTaskSchedule=FULL
    AlarmVerify0 (OsAlarm): OsAlarmCounterRef=CounterVerify0
      OsAlarmAction
        OsAlarmCallback: OsAlarmCallbackName=AlarmCallBackVerify0
    CounterVerify0 (OsCounter): OsCounterMaxAllowedValue=10, OsCounterMinCycle=1, OsCounterTicksPerBase=1, OsCounterType=SOFTWARE
    DummyResource (OsResource): OsResourceProperty=STANDARD
    DummyEvent (OsEvent)
    3 x OsApplication, all with OsTrusted=true:
      TRUSTED_MAIN_OSAP: OsApplicationCoreAssignment=OS_CORE_ID_0, OsAppTaskRef=MainTask, OsAppTaskRef=DummyTask
        OsApplicationHooks: OsAppErrorHook=false, OsAppShutdownHook=false, OsAppStartupHook=false
      OSAP_OTHER_OTHER_CORE: OsApplicationCoreAssignment=OS_CORE_ID_1, OsAppTaskRef=RunTask1, OsAppTaskRef=MainTask1, OsAppAlarmRef=AlarmVerify1, OsAppCounterRef=CounterVerify1
        OsApplicationHooks: OsAppErrorHook=true, OsAppShutdownHook=true, OsAppStartupHook=true
      OSAP_SELF_CORE: OsApplicationCoreAssignment=OS_CORE_ID_0, OsAppTaskRef=RunTask0, OsAppAlarmRef=AlarmVerify0, OsAppCounterRef=CounterVerify0
        OsApplicationHooks: OsAppErrorHook=true, OsAppShutdownHook=true, OsAppStartupHook=true
