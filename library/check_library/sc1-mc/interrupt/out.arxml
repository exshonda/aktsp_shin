AUTOSAR XML (schema 4-0-3)
package /Os
  module config Os: ecuc-def-edition=4.2.0, implementation-config-variant=VARIANT-PRE-COMPILE
    OsInclude: OsIncludeFileName=out.h
    MainApp (OsAppMode)
    OsOS: OsNumberOfCores=2, OsStackMonitoring=true, OsUseGetServiceId=true, OsUseParameterAccess=true, OsStatus=EXTENDED, OsScalabilityClass=SC1
      OsHooks: OsErrorHook=true, OsPostTaskHook=true, OsPreTaskHook=true, OsProtectionHook=true, OsShutdownHook=true, OsStartupHook=true
      OsHookStack_0 (OsHookStack): OsHookStackSize=AKTSP_HOOK_STACK_SIZE, OsHookStackCoreAssignment=OS_CORE_ID_0
      OsHookStack_1 (OsHookStack): OsHookStackSize=AKTSP_HOOK_STACK_SIZE, OsHookStackCoreAssignment=OS_CORE_ID_1
      OsOsStack_0 (OsOsStack): OsOsStackSize=AKTSP_OS_STACK_SIZE, OsOsStackCoreAssignment=OS_CORE_ID_0
      OsOsStack_1 (OsOsStack): OsOsStackSize=AKTSP_OS_STACK_SIZE, OsOsStackCoreAssignment=OS_CORE_ID_1
    MainTask (OsTask):
      OsTaskActivation = 1
      OsTaskPriority = 0
      OsTaskStackSize = AKTSP_TASK_STACK_SIZE
      OsTaskSchedule = FULL
      OsTaskResourceRef = DummyResource
      OsTaskEventRef = DummyEvent
      OsTaskAutostart: OsTaskAppModeRef=MainApp
    DummyTask (OsTask): OsTaskActivation=1, OsTaskPriority=15, OsTaskStackSize=AKTSP_TASK_STACK_SIZE, OsTaskSchedule=FULL, OsTaskResourceRef=DummyResource
    4 x OsIsr:
      AKTG_C1ISR_COMMON_AKTSP_INTNO_CORE2_A: OsIsrInterruptNumber=AKTSP_INTNO_CORE2_A, OsIsrInterruptPriority=AKTSP_INT_PRI_ISR1, OsIsrCategory=CATEGORY_1
      AKTG_C2ISR_COMMON_AKTSP_INTNO_CORE2_B: OsIsrInterruptNumber=AKTSP_INTNO_CORE2_B, OsIsrInterruptPriority=AKTSP_INT_PRI_HIGH, OsIsrStackSize=AKTSP_C2ISR_STACK_SIZE, OsIsrCategory=CATEGORY_2
      AKTG_C2ISR_COMMON_AKTSP_INTNO_CORE2_C: OsIsrInterruptNumber=AKTSP_INTNO_CORE2_C, OsIsrInterruptPriority=AKTSP_INT_PRI_MID, OsIsrStackSize=AKTSP_C2ISR_STACK_SIZE, OsIsrCategory=CATEGORY_2
      AKTG_C2ISR_COMMON_AKTSP_INTNO_CORE2_D: OsIsrInterruptNumber=AKTSP_INTNO_CORE2_D, OsIsrInterruptPriority=AKTSP_INT_PRI_LOW, OsIsrStackSize=AKTSP_C2ISR_STACK_SIZE, OsIsrCategory=CATEGORY_2
    CounterVerify1 (OsCounter): OsCounterMaxAllowedValue=10, OsCounterMinCycle=1, OsCounterTicksPerBase=1, OsCounterType=SOFTWARE
    AlarmVerify1 (OsAlarm): OsAlarmCounterRef=CounterVerify1
      OsAlarmAction
        OsAlarmCallback: OsAlarmCallbackName=AlarmCallBackVerify1
    MainTask1 (OsTask): OsTaskActivation=1, OsTaskPriority=1, OsTaskStackSize=AKTSP_TASK_STACK_SIZE, OsTaskSchedule=FULL
      OsTaskAutostart: OsTaskAppModeRef=MainApp
    RunTask1 (OsTask): OsTaskActivation=1, OsTaskPriority=2, OsTaskStackSize=AKTSP_TASK_STACK_SIZE, OsTaskSchedule=FULL
    4 x OsIsr:
      AKTG_C1ISR_COMMON_AKTSP_INTNO_A: OsIsrInterruptNumber=AKTSP_INTNO_A, OsIsrInterruptPriority=AKTSP_INT_PRI_ISR1, OsIsrCategory=CATEGORY_1
      AKTG_C2ISR_COMMON_AKTSP_INTNO_B: OsIsrInterruptNumber=AKTSP_INTNO_B, OsIsrInterruptPriority=AKTSP_INT_PRI_HIGH, OsIsrStackSize=AKTSP_C2ISR_STACK_SIZE, OsIsrCategory=CATEGORY_2
      AKTG_C2ISR_COMMON_AKTSP_INTNO_C: OsIsrInterruptNumber=AKTSP_INTNO_C, OsIsrInterruptPriority=AKTSP_INT_PRI_MID, OsIsrStackSize=AKTSP_C2ISR_STACK_SIZE, OsIsrCategory=CATEGORY_2
      AKTG_C2ISR_COMMON_AKTSP_INTNO_D: OsIsrInterruptNumber=AKTSP_INTNO_D, OsIsrInterruptPriority=AKTSP_INT_PRI_LOW, OsIsrStackSize=AKTSP_C2ISR_STACK_SIZE, OsIsrCategory=CATEGORY_2
    CounterVerify0 (OsCounter): OsCounterMaxAllowedValue=10, OsCounterMinCycle=1, OsCounterTicksPerBase=1, OsCounterType=SOFTWARE
    AlarmVerify0 (OsAlarm): OsAlarmCounterRef=CounterVerify0
      OsAlarmAction
        OsAlarmCallback: OsAlarmCallbackName=AlarmCallBackVerify0
    RunTask0 (OsTask): OsTaskActivation=1, OsTaskPriority=2, OsTaskStackSize=AKTSP_TASK_STACK_SIZE, OsTaskSchedule=FULL
    DummyResource (OsResource): OsResourceProperty=STANDARD
    DummyEvent (OsEvent)
    3 x OsApplication, all with OsTrusted=true:
      TRUSTED_MAIN_OSAP: OsApplicationCoreAssignment=OS_CORE_ID_0, OsAppTaskRef=MainTask, OsAppTaskRef=DummyTask
        OsApplicationHooks: OsAppErrorHook=false, OsAppShutdownHook=false, OsAppStartupHook=false
      OSAP_OTHER_OTHER_CORE: OsApplicationCoreAssignment=OS_CORE_ID_1, OsAppIsrRef=AKTG_C1ISR_COMMON_AKTSP_INTNO_CORE2_A, OsAppIsrRef=AKTG_C2ISR_COMMON_AKTSP_INTNO_CORE2_B, OsAppIsrRef=AKTG_C2ISR_COMMON_AKTSP_INTNO_CORE2_C, OsAppIsrRef=AKTG_C2ISR_COMMON_AKTSP_INTNO_CORE2_D, OsAppCounterRef=CounterVerify1, OsAppAlarmRef=AlarmVerify1, OsAppTaskRef=MainTask1, OsAppTaskRef=RunTask1
        OsApplicationHooks: OsAppErrorHook=true, OsAppShutdownHook=true, OsAppStartupHook=true
      OSAP_SELF_CORE: OsApplicationCoreAssignment=OS_CORE_ID_0, OsAppIsrRef=AKTG_C1ISR_COMMON_AKTSP_INTNO_A, OsAppIsrRef=AKTG_C2ISR_COMMON_AKTSP_INTNO_B, OsAppIsrRef=AKTG_C2ISR_COMMON_AKTSP_INTNO_C, OsAppIsrRef=AKTG_C2ISR_COMMON_AKTSP_INTNO_D, OsAppCounterRef=CounterVerify0, OsAppAlarmRef=AlarmVerify0, OsAppTaskRef=RunTask0
        OsApplicationHooks: OsAppErrorHook=true, OsAppShutdownHook=true, OsAppStartupHook=true
