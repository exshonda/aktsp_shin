AUTOSAR XML (schema 4-0-3)
package /Os
  module config Os: ecuc-def-edition=4.2.0, implementation-config-variant=VARIANT-PRE-COMPILE
    OsInclude: OsIncludeFileName=out.h
    MainApp (OsAppMode)
    OsOS: OsStackMonitoring=true, OsUseGetServiceId=true, OsUseParameterAccess=true, OsStatus=EXTENDED, OsScalabilityClass=SC1
      OsHooks: OsErrorHook=true, OsPostTaskHook=true, OsPreTaskHook=true, OsProtectionHook=true, OsShutdownHook=true, OsStartupHook=true
      OsHookStack: OsHookStackSize=AKTSP_HOOK_STACK_SIZE
      OsOsStack: OsOsStackSize=AKTSP_OS_STACK_SIZE
    MainTask (OsTask):
      OsTaskActivation = 1
      OsTaskPriority = 0
      OsTaskStackSize = AKTSP_TASK_STACK_SIZE
      OsTaskSchedule = FULL
      OsTaskResourceRef = DummyResource
      OsTaskEventRef = DummyEvent
      OsTaskAutostart: OsTaskAppModeRef=MainApp
    DummyTask (OsTask): OsTaskActivation=1, OsTaskPriority=15, OsTaskStackSize=AKTSP_TASK_STACK_SIZE, OsTaskSchedule=FULL, OsTaskResourceRef=DummyResource
    DummyResource (OsResource): OsResourceProperty=STANDARD
    DummyEvent (OsEvent)
    4 x OsIsr:
      AKTG_C1ISR_COMMON_AKTSP_INTNO_A: OsIsrInterruptNumber=AKTSP_INTNO_A, OsIsrInterruptPriority=AKTSP_INT_PRI_ISR1, OsIsrCategory=CATEGORY_1
      AKTG_C2ISR_COMMON_AKTSP_INTNO_B: OsIsrInterruptNumber=AKTSP_INTNO_B, OsIsrInterruptPriority=AKTSP_INT_PRI_HIGH, OsIsrStackSize=AKTSP_C2ISR_STACK_SIZE, OsIsrCategory=CATEGORY_2
      AKTG_C2ISR_COMMON_AKTSP_INTNO_C: OsIsrInterruptNumber=AKTSP_INTNO_C, OsIsrInterruptPriority=AKTSP_INT_PRI_MID, OsIsrStackSize=AKTSP_C2ISR_STACK_SIZE, OsIsrCategory=CATEGORY_2
      AKTG_C2ISR_COMMON_AKTSP_INTNO_D: OsIsrInterruptNumber=AKTSP_INTNO_D, OsIsrInterruptPriority=AKTSP_INT_PRI_LOW, OsIsrStackSize=AKTSP_C2ISR_STACK_SIZE, OsIsrCategory=CATEGORY_2
    RunTask (OsTask): OsTaskActivation=1, OsTaskPriority=2, OsTaskStackSize=AKTSP_TASK_STACK_SIZE, OsTaskSchedule=FULL
    CounterVerify (OsCounter): OsCounterMaxAllowedValue=10, OsCounterMinCycle=1, OsCounterTicksPerBase=1, OsCounterType=SOFTWARE
    AlarmVerify (OsAlarm): OsAlarmCounterRef=CounterVerify
      OsAlarmAction
        OsAlarmCallback: OsAlarmCallbackName=AlarmCallBackVerify
