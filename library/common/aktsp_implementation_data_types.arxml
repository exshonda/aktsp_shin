AUTOSAR XML (schema 4-0-3)
# Copyright (C) 2011-2014 by Center for Embedded Computing Systems
# Graduate School of Information Science, Nagoya Univ., JAPAN
# Copyright (C) 2011-2014 by FUJI SOFT INCORPORATED, JAPAN
# Copyright (C) 2011-2013 by Spansion LLC, USA
# Copyright (C) 2011-2013 by NEC Communication Systems, Ltd., JAPAN
# Copyright (C) 2011-2014 by Panasonic Advanced Technology Development Co., Ltd., JAPAN
# Copyright (C) 2011-2014 by Renesas Electronics Corporation, JAPAN
# Copyright (C) 2011-2014 by Sunny Giken Inc., JAPAN
# Copyright (C) 2011-2014 by TOSHIBA CORPORATION, JAPAN
# Copyright (C) 2011-2014 by Witz Corporation, JAPAN
standard types defined: uint8, uint16, uint32
package /ImplementationDataTypes
  7 x impl type:
    AktspUint8Pointer: category=VALUE
    AktspUint16Pointer: category=VALUE
    AktspUint32Pointer: category=VALUE
    AktspIocDataStructTypePrim: category=VALUE
    AktspIocDataStructTypeNoPrim: category=STRUCTURE
    AktspIocDataIntegerTypePrim: category=VALUE
    AktspIocDataIntegerTypeNoPrim: category=DATA_REFERENCE
