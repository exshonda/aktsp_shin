AUTOSAR XML (schema 4-0-3)
package /Ecuc
  module config Os: ecuc-def-edition=4.2.0, implementation-config-variant=VARIANT-PRE-COMPILE
    OsInclude: OsIncludeFileName=out.h
    AppMode1 (OsAppMode)
    OsOS: OsNumberOfCores=2, OsStackMonitoring=true, OsUseGetServiceId=true, OsUseParameterAccess=true, OsScalabilityClass=SC3, OsStatus=EXTENDED
      OsHooks: OsErrorHook=true, OsPostTaskHook=true, OsPreTaskHook=true, OsProtectionHook=true, OsShutdownHook=true, OsStartupHook=true
      OsHookStack: OsHookStackSize=512, OsHookStackCoreAssignment=0
    MainTask (OsTask): OsTaskActivation=8, OsTaskPriority=12, OsTaskStackSize=592, OsTaskSchedule=FULL
      OsTaskAutostart: OsTaskAppModeRef=AppMode1
    Task2 (OsTask): OsTaskActivation=1, OsTaskPriority=12, OsTaskStackSize=592, OsTaskSchedule=FULL
    4 x OsAlarm, all with OsAlarmCounterRef=MAIN_HW_COUNTER_CORE0:
      ActTskArm1
        OsAlarmAction
          OsAlarmActivateTask: OsAlarmActivateTaskRef=MainTask
      ActTskArm2
        OsAlarmAction
          OsAlarmActivateTask: OsAlarmActivateTaskRef=Task2
      ActTskArm3
        OsAlarmAction
          OsAlarmActivateTask: OsAlarmActivateTaskRef=Task3
      ActTskArm4
        OsAlarmAction
          OsAlarmActivateTask: OsAlarmActivateTaskRef=Task4
    Task3 (OsTask): OsTaskActivation=1, OsTaskPriority=12, OsTaskStackSize=592, OsTaskSchedule=FULL
    Task4 (OsTask): OsTaskActivation=5, OsTaskPriority=12, OsTaskStackSize=592, OsTaskSchedule=FULL
    Osap1 (OsApplication):
      OsTrusted = true
      OsApplicationCoreAssignment = 0
      OsAppTaskRef = MainTask
      OsAppTaskRef = Task{2..4}
      OsAppAlarmRef = ActTskArm{1..4}
      8 x OsApplicationTrustedFunction, all with OsTrustedFunctionStackSize=598:
        AktspTfnActivateTask: OsTrustedFunctionName=TRUSTED_AktspTfnActivateTask
        AktspTfnSetEvent: OsTrustedFunctionName=TRUSTED_AktspTfnSetEvent
        AktspTfnShutdownOS: OsTrustedFunctionName=TRUSTED_AktspTfnShutdownOS
        AktspTfnRaiseInterCoreInterrupt: OsTrustedFunctionName=TRUSTED_AktspTfnRaiseInterCoreInterrupt
        AktspTfnActivateTask_1: OsTrustedFunctionName=TRUSTED_AktspTfnActivateTask
        AktspTfnSetEvent_1: OsTrustedFunctionName=TRUSTED_AktspTfnSetEvent
        AktspTfnShutdownOS_1: OsTrustedFunctionName=TRUSTED_AktspTfnShutdownOS
        AktspTfnRaiseInterCoreInterrupt_1: OsTrustedFunctionName=TRUSTED_AktspTfnRaiseInterCoreInterrupt
