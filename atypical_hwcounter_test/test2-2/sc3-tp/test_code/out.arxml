AUTOSAR XML (schema 4-0-3)
package /Ecuc
  module config Os: ecuc-def-edition=4.2.0, implementation-config-variant=VARIANT-PRE-COMPILE
    OsInclude: OsIncludeFileName=out.h
    AppMode1 (OsAppMode)
    OsOS: OsStackMonitoring=true, OsUseGetServiceId=true, OsUseParameterAccess=true, OsScalabilityClass=SC3, OsStatus=EXTENDED
      OsHooks: OsErrorHook=true, OsPostTaskHook=true, OsPreTaskHook=true, OsProtectionHook=true, OsShutdownHook=true, OsStartupHook=true
      OsHookStack: OsHookStackSize=512
      OsSystemCycle: OsSystemCycleTime=4
        TWD1 (OsSystemCycleTimeWindow): OsSystemCycleTimeWindowStart=0.0, OsSystemCycleTimeWindowLength=1.5
    MainTask (OsTask): OsTaskActivation=8, OsTaskPriority=12, OsTaskStackSize=592, OsTaskSchedule=FULL
      OsTaskAutostart: OsTaskAppModeRef=AppMode1
    Task2 (OsTask): OsTaskActivation=1, OsTaskPriority=12, OsTaskStackSize=592, OsTaskSchedule=FULL
    4 x OsAlarm, all with OsAlarmCounterRef=MAIN_HW_COUNTER:
      ActTskArm1
        OsAlarmAction
          OsAlarmActivateTask: OsAlarmActivateTaskRef=MainTask
      ActTskArm2
        OsAlarmAction
          OsAlarmActivateTask: OsAlarmActivateTaskRef=Task2
      ActTskArm3
        OsAlarmAction
          OsAlarmActivateTask: OsAlarmActivateTaskRef=Task3
      ActTskArm4
        OsAlarmAction
          OsAlarmActivateTask: OsAlarmActivateTaskRef=Task4
    Task3 (OsTask): OsTaskActivation=1, OsTaskPriority=12, OsTaskStackSize=592, OsTaskSchedule=FULL
    Task4 (OsTask): OsTaskActivation=5, OsTaskPriority=12, OsTaskStackSize=592, OsTaskSchedule=FULL
    Osap1 (OsApplication):
      OsTrusted = true
      OsAppTaskRef = MainTask
      OsAppTaskRef = Task{2..4}
      OsAppAlarmRef = ActTskArm{1..4}
      3 x OsApplicationTrustedFunction, all with OsTrustedFunctionStackSize=598:
        AktspTfnActivateTask: OsTrustedFunctionName=TRUSTED_AktspTfnActivateTask
        AktspTfnSetEvent: OsTrustedFunctionName=TRUSTED_AktspTfnSetEvent
        AktspTfnShutdownOS: OsTrustedFunctionName=TRUSTED_AktspTfnShutdownOS
    DummyOsap (OsApplication): OsTrusted=true, OsSystemCycleTimeWindowRef=TWD1
