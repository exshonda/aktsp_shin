AUTOSAR XML (schema 4-0-3)
package /Ecuc
  module config Os: ecuc-def-edition=4.2.0, implementation-config-variant=VARIANT-PRE-COMPILE
    OsInclude: OsIncludeFileName=target_hw_counter.h
    OSAP_for_MAIN_HW_COUNTER_CORE0 (OsApplication): OsTrusted=true, OsApplicationCoreAssignment=0, OsAppCounterRef=MAIN_HW_COUNTER_CORE0, OsAppIsrRef=C2ISR_for_MAIN_HW_COUNTER_CORE0
      OsApplicationHooks: OsAppErrorHook=false, OsAppShutdownHook=false, OsAppStartupHook=false
    MAIN_HW_COUNTER_CORE0 (OsCounter):
      OsCounterMaxAllowedValue = 536870911
      OsCounterMinCycle = 4000
      OsCounterTicksPerBase = 10
      OsSecondsPerTick = 1.666666e-08
      OsCounterType = HARDWARE
      OsCounterIsrRef = C2ISR_for_MAIN_HW_COUNTER_CORE0
    C2ISR_for_MAIN_HW_COUNTER_CORE0 (OsIsr): OsIsrInterruptNumber=65552, OsIsrInterruptPriority=1, OsIsrStackSize=592, OsIsrCategory=CATEGORY_2, OsIsrInterruptSource=ENABLE
    OSAP_for_MAIN_HW_COUNTER_CORE1 (OsApplication): OsTrusted=true, OsApplicationCoreAssignment=1, OsAppCounterRef=MAIN_HW_COUNTER_CORE1, OsAppIsrRef=C2ISR_for_MAIN_HW_COUNTER_CORE1
      OsApplicationHooks: OsAppErrorHook=false, OsAppShutdownHook=false, OsAppStartupHook=false
    MAIN_HW_COUNTER_CORE1 (OsCounter):
      OsCounterMaxAllowedValue = 536870911
      OsCounterMinCycle = 4000
      OsCounterTicksPerBase = 10
      OsSecondsPerTick = 1.666666e-08
      OsCounterType = HARDWARE
      OsCounterIsrRef = C2ISR_for_MAIN_HW_COUNTER_CORE1
    C2ISR_for_MAIN_HW_COUNTER_CORE1 (OsIsr): OsIsrInterruptNumber=131088, OsIsrInterruptPriority=1, OsIsrStackSize=592, OsIsrCategory=CATEGORY_2, OsIsrInterruptSource=ENABLE
